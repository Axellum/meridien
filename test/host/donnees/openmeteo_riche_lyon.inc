// FICHIER GÉNÉRÉ par test/host/controle_python_riche.py : ne pas modifier à la main.
// Réponse réelle d'Open-Meteo (lyon, requête du firmware), voir donnees/LISEZMOI.md.
R"OM({"latitude":45.755363,"longitude":4.852546,"generationtime_ms":1.6733407974243164,"utc_offset_seconds":3600,"timezone":"Europe/Paris","timezone_abbreviation":"GMT+1","elevation":176.0,"current_units":{"time":"unixtime","interval":"seconds","temperature_2m":"°C","apparent_temperature":"°C","is_day":"","precipitation":"mm","weather_code":"wmo code","cloud_cover":"%","wind_speed_10m":"km/h","wind_direction_10m":"°","wind_gusts_10m":"km/h","pressure_msl":"hPa","relative_humidity_2m":"%"},"current":{"time":1794006000,"interval":900,"temperature_2m":7.4,"apparent_temperature":6.4,"is_day":0,"precipitation":0.00,"weather_code":45,"cloud_cover":48,"wind_speed_10m":1.5,"wind_direction_10m":346,"wind_gusts_10m":1.8,"pressure_msl":1024.9,"relative_humidity_2m":98},"minutely_15_units":{"time":"unixtime","precipitation":"mm"},"minutely_15":{"time":[1794006000,1794006900,1794007800,1794008700,1794009600,1794010500,1794011400,1794012300,1794013200],"precipitation":[0.00,0.00,0.00,0.00,0.00,0.00,0.00,0.00,0.00]},"hourly_units":{"time":"unixtime","temperature_2m":"°C","apparent_temperature":"°C","relative_humidity_2m":"%","precipitation_probability":"%","precipitation":"mm","weather_code":"wmo code","cloud_cover":"%","wind_speed_10m":"km/h","wind_direction_10m":"°","wind_gusts_10m":"km/h","uv_index":"","is_day":""},"hourly":{"time":[1794006000,1794009600,1794013200,1794016800,1794020400,1794024000,1794027600,1794031200,1794034800,1794038400,1794042000,1794045600,1794049200,1794052800,1794056400,1794060000,1794063600,1794067200,1794070800,1794074400,1794078000,1794081600,1794085200,1794088800,1794092400],"temperature_2m":[7.4,6.6,6.2,5.7,5.3,4.9,4.4,4.4,4.6,5.4,6.7,8.3,9.4,10.2,10.7,10.8,10.7,10.3,9.7,9.1,8.3,7.1,6.4,5.7,4.9],"apparent_temperature":[6.4,5.5,4.9,4.1,3.5,3.1,2.8,2.7,2.7,3.4,4.6,6.5,8.0,8.7,9.0,9.0,8.7,8.4,8.0,7.4,7.0,5.5,4.9,4.1,3.0],"relative_humidity_2m":[98,99,95,94,93,93,96,95,93,88,83,76,70,67,66,66,66,69,73,76,81,91,93,94,93],"precipitation_probability":[0,0,0,0,0,0,0,0,0,0,0,0,0,0,0,0,0,0,0,0,0,0,0,0,0],"precipitation":[0.00,0.00,0.00,0.00,0.00,0.00,0.00,0.00,0.00,0.00,0.00,0.00,0.00,0.00,0.00,0.00,0.00,0.00,0.00,0.00,0.00,0.00,0.00,0.00,0.00],"weather_code":[45,45,45,2,1,1,45,2,3,2,2,2,2,2,2,2,1,2,2,1,0,0,1,1,1],"cloud_cover":[48,81,65,66,0,0,18,59,94,97,77,77,39,66,59,48,29,40,59,0,0,0,0,0,0],"wind_speed_10m":[1.5,1.6,1.5,2.3,2.9,1.8,1.1,1.4,2.3,3.3,5.0,2.4,0.5,1.4,2.5,3.4,4.2,4.2,3.7,2.9,1.1,3.3,1.9,2.4,2.5],"wind_direction_10m":[346,297,315,342,330,11,342,270,252,264,270,297,315,90,82,72,59,59,61,30,252,229,248,207,188],"wind_gusts_10m":[1.8,3.2,4.3,4.7,5.8,5.8,4.0,2.5,4.7,7.9,11.9,12.6,6.1,6.5,8.3,9.4,10.8,10.1,6.5,6.5,4.7,6.5,6.1,4.3,6.1],"uv_index":[0.00,0.00,0.00,0.00,0.00,0.00,0.00,0.00,0.05,0.50,1.30,2.10,2.65,2.85,2.60,1.95,1.15,0.35,0.00,0.00,0.00,0.00,0.00,0.00,0.00],"is_day":[0,0,0,0,0,0,0,0,1,1,1,1,1,1,1,1,1,1,0,0,0,0,0,0,0]},"daily_units":{"time":"unixtime","weather_code":"wmo code","temperature_2m_max":"°C","temperature_2m_min":"°C","apparent_temperature_max":"°C","apparent_temperature_min":"°C","sunrise":"unixtime","sunset":"unixtime","sunshine_duration":"s","uv_index_max":"","precipitation_sum":"mm","snowfall_sum":"cm","precipitation_hours":"h","precipitation_probability_max":"%","wind_speed_10m_max":"km/h","wind_gusts_10m_max":"km/h","wind_direction_10m_dominant":"°"},"daily":{"time":[1794006000,1794092400,1794178800,1794265200,1794351600,1794438000,1794524400],"weather_code":[45,45,61,61,80,80,61],"temperature_2m_max":[10.8,13.9,16.7,18.9,19.6,17.1,11.9],"temperature_2m_min":[4.4,2.6,9.8,13.3,12.3,11.0,8.1],"apparent_temperature_max":[9.0,11.8,14.0,19.4,19.4,16.9,12.2],"apparent_temperature_min":[2.7,0.8,9.0,13.2,12.2,10.9,6.5],"sunrise":[1794032936,1794119422,1794205908,1794292393,1794378879,1794465363,1794551848],"sunset":[1794068347,1794154670,1794240994,1794327319,1794413647,1794499977,1794586309],"sunshine_duration":[30776.60,18085.58,143.35,32400.00,29493.38,9944.70,0.00],"uv_index_max":[2.85,2.80,2.35,1.40,1.60,0.25,1.15],"precipitation_sum":[0.00,0.00,5.80,3.20,2.00,0.90,6.60],"snowfall_sum":[0.00,0.00,0.00,0.00,0.00,0.00,0.00],"precipitation_hours":[0.0,0.0,5.0,9.0,5.0,3.0,9.0],"precipitation_probability_max":[0,5,74,93,38,53,56],"wind_speed_10m_max":[5.0,12.4,20.5,9.4,9.4,13.4,10.5],"wind_gusts_10m_max":[12.6,27.0,46.8,23.0,25.6,27.4,22.0],"wind_direction_10m_dominant":[337,178,168,165,167,147,358]}})OM"
