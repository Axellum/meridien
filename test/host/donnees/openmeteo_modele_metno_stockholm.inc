// FICHIER GÉNÉRÉ par test/host/controle_python_modeles.py : ne pas modifier à la main.
// Réponse réelle d'Open-Meteo (metno, Stockholm, requête complète du firmware + models=), voir donnees/LISEZMOI.md.
R"OM({"latitude":59.3289,"longitude":18.072357,"generationtime_ms":0.6115436553955078,"utc_offset_seconds":3600,"timezone":"Europe/Stockholm","timezone_abbreviation":"GMT+1","elevation":21.0,"current_units":{"time":"unixtime","interval":"seconds","temperature_2m":"°C","apparent_temperature":"°C","is_day":"","precipitation":"mm","weather_code":"wmo code","cloud_cover":"%","wind_speed_10m":"km/h","wind_direction_10m":"°","wind_gusts_10m":"km/h","pressure_msl":"hPa","relative_humidity_2m":"%"},"current":{"time":1794040200,"interval":900,"temperature_2m":2.5,"apparent_temperature":-1.6,"is_day":1,"precipitation":0.00,"weather_code":0,"cloud_cover":2,"wind_speed_10m":14.4,"wind_direction_10m":280,"wind_gusts_10m":28.4,"pressure_msl":1026.1,"relative_humidity_2m":87},"minutely_15_units":{"time":"unixtime","precipitation":"mm"},"minutely_15":{"time":[1794040200,1794041100,1794042000,1794042900,1794043800,1794044700,1794045600,1794046500,1794047400],"precipitation":[0.00,0.00,0.00,0.00,0.00,0.00,0.00,0.00,0.00]},"hourly_units":{"time":"unixtime","temperature_2m":"°C","apparent_temperature":"°C","relative_humidity_2m":"%","precipitation_probability":"%","precipitation":"mm","weather_code":"wmo code","cloud_cover":"%","wind_speed_10m":"km/h","wind_direction_10m":"°","wind_gusts_10m":"km/h","uv_index":"","is_day":""},"hourly":{"time":[1794038400,1794042000,1794045600,1794049200,1794052800,1794056400,1794060000,1794063600,1794067200,1794070800,1794074400,1794078000,1794081600,1794085200,1794088800,1794092400,1794096000,1794099600,1794103200,1794106800,1794110400,1794114000,1794117600,1794121200,1794124800],"temperature_2m":[2.3,2.9,3.7,4.3,4.8,4.9,4.6,4.1,3.8,3.3,2.9,2.7,2.5,2.4,2.2,2.1,1.9,1.6,1.4,1.3,1.1,1.3,1.2,1.0,1.4],"apparent_temperature":[-1.9,-1.2,-0.4,0.4,1.0,1.1,0.8,0.3,-0.1,-0.4,-0.8,-1.0,-1.2,-1.2,-1.4,-1.7,-1.9,-2.1,-2.3,-2.3,-2.5,-2.5,-2.7,-2.8,-2.1],"relative_humidity_2m":[89,85,81,78,77,76,78,82,83,86,87,88,88,89,89,89,90,90,91,91,92,91,91,91,89],"precipitation_probability":[0,0,0,0,0,0,0,0,0,0,0,0,0,0,0,0,0,0,0,0,0,0,0,0,0],"precipitation":[0.00,0.00,0.00,0.00,0.00,0.00,0.00,0.00,0.00,0.00,0.00,0.00,0.00,0.00,0.00,0.00,0.00,0.00,0.00,0.00,0.00,0.00,0.00,0.00,0.00],"weather_code":[0,0,0,0,0,0,0,1,2,2,2,3,3,3,3,2,1,1,0,1,2,2,2,1,0],"cloud_cover":[6,1,0,1,0,0,7,38,53,67,71,83,83,92,95,67,45,20,7,29,56,62,66,35,7],"wind_speed_10m":[14.8,14.4,14.0,13.3,13.0,12.6,13.3,13.0,13.7,12.6,12.2,11.5,11.9,11.2,11.2,11.9,11.5,11.2,10.8,10.1,10.4,11.9,11.9,10.8,9.7],"wind_direction_10m":[279,280,277,280,280,271,271,271,272,278,277,274,275,275,274,269,267,262,263,265,267,266,266,267,266],"wind_gusts_10m":[28.8,28.4,27.7,27.4,25.6,24.8,24.8,23.8,24.1,24.1,22.0,21.6,20.9,21.2,19.4,21.2,20.9,20.2,19.4,18.4,18.0,20.9,21.6,21.6,19.4],"uv_index":[0.30,0.70,0.95,1.10,1.00,0.70,0.35,0.05,0.00,0.00,0.00,0.00,0.00,0.00,0.00,0.00,0.00,0.00,0.00,0.00,0.00,0.00,0.00,0.05,0.30],"is_day":[1,1,1,1,1,1,1,0,0,0,0,0,0,0,0,0,0,0,0,0,0,0,0,1,1]},"daily_units":{"time":"unixtime","weather_code":"wmo code","temperature_2m_max":"°C","temperature_2m_min":"°C","apparent_temperature_max":"°C","apparent_temperature_min":"°C","sunrise":"unixtime","sunset":"unixtime","sunshine_duration":"s","uv_index_max":"","precipitation_sum":"mm","snowfall_sum":"cm","precipitation_hours":"h","precipitation_probability_max":"%","wind_speed_10m_max":"km/h","wind_gusts_10m_max":"km/h","wind_direction_10m_dominant":"°"},"daily":{"time":[1794006000,1794092400,1794178800,1794265200,1794351600,1794438000,1794524400],"weather_code":[3,3,3,51,51,3,0],"temperature_2m_max":[4.9,4.8,5.5,4.8,4.2,5.8,3.3],"temperature_2m_min":[2.1,1.0,2.8,3.3,2.6,1.4,-0.3],"apparent_temperature_max":[1.1,1.5,2.2,1.6,1.1,2.9,-1.8],"apparent_temperature_min":[-2.0,-2.8,-0.6,-0.1,-0.1,-2.3,-5.0],"sunrise":[1794032504,1794119055,1794205605,1794292155,1794378704,1794465252,1794551799],"sunset":[1794062417,1794148674,1794234934,1794321196,1794407460,1794493727,1794579996],"sunshine_duration":[25200.00,25200.00,651.39,0.00,0.00,18627.65,25200.00],"uv_index_max":[1.10,1.05,1.00,0.95,0.30,0.80,0.35],"precipitation_sum":[0.00,0.00,0.00,0.10,2.30,0.00,0.00],"snowfall_sum":[0.00,0.00,0.00,0.00,0.00,0.00,0.00],"precipitation_hours":[0.0,0.0,0.0,1.0,8.0,0.0,0.0],"precipitation_probability_max":[0,0,0,16,18,36,31],"wind_speed_10m_max":[17.6,13.0,15.1,11.1,13.1,14.9,17.7],"wind_gusts_10m_max":[32.4,24.1,28.1,23.8,32.8,33.5,40.3],"wind_direction_10m_dominant":[274,265,233,213,247,207,258]}})OM"
