// FICHIER GÉNÉRÉ par test/host/controle_python_modeles.py : ne pas modifier à la main.
// Réponse réelle d'Open-Meteo (noaa, Le Cap, requête complète du firmware + models=), voir donnees/LISEZMOI.md.
R"OM({"latitude":-33.914734,"longitude":18.515625,"generationtime_ms":0.5629062652587891,"utc_offset_seconds":7200,"timezone":"Africa/Johannesburg","timezone_abbreviation":"GMT+2","elevation":17.0,"current_units":{"time":"unixtime","interval":"seconds","temperature_2m":"°C","apparent_temperature":"°C","is_day":"","precipitation":"mm","weather_code":"wmo code","cloud_cover":"%","wind_speed_10m":"km/h","wind_direction_10m":"°","wind_gusts_10m":"km/h","pressure_msl":"hPa","relative_humidity_2m":"%"},"current":{"time":1794040200,"interval":900,"temperature_2m":18.7,"apparent_temperature":16.9,"is_day":1,"precipitation":0.00,"weather_code":1,"cloud_cover":22,"wind_speed_10m":16.2,"wind_direction_10m":176,"wind_gusts_10m":19.8,"pressure_msl":1021.8,"relative_humidity_2m":43},"minutely_15_units":{"time":"unixtime","precipitation":"mm"},"minutely_15":{"time":[1794040200,1794041100,1794042000,1794042900,1794043800,1794044700,1794045600,1794046500,1794047400],"precipitation":[0.00,0.00,0.00,0.00,0.00,0.00,0.00,0.00,0.00]},"hourly_units":{"time":"unixtime","temperature_2m":"°C","apparent_temperature":"°C","relative_humidity_2m":"%","precipitation_probability":"%","precipitation":"mm","weather_code":"wmo code","cloud_cover":"%","wind_speed_10m":"km/h","wind_direction_10m":"°","wind_gusts_10m":"km/h","uv_index":"","is_day":""},"hourly":{"time":[1794038400,1794042000,1794045600,1794049200,1794052800,1794056400,1794060000,1794063600,1794067200,1794070800,1794074400,1794078000,1794081600,1794085200,1794088800,1794092400,1794096000,1794099600,1794103200,1794106800,1794110400,1794114000,1794117600,1794121200,1794124800],"temperature_2m":[18.4,18.9,19.1,19.5,19.6,19.1,18.6,18.2,17.8,16.8,16.2,16.2,15.9,15.6,15.0,14.5,14.0,13.8,13.6,13.5,13.2,14.3,16.3,18.4,21.4],"apparent_temperature":[16.4,16.9,16.8,16.8,16.4,14.9,13.5,12.1,12.0,11.2,11.0,11.8,12.3,12.8,12.6,12.3,12.1,12.1,11.8,11.5,11.0,12.1,13.9,16.3,20.4],"relative_humidity_2m":[43,44,45,43,43,45,47,48,49,52,54,53,54,55,59,62,65,65,65,65,66,61,51,41,30],"precipitation_probability":[16,13,9,4,0,0,0,0,0,0,0,0,0,0,0,0,0,0,0,0,0,0,0,0,0],"precipitation":[0.00,0.00,0.00,0.00,0.00,0.00,0.00,0.00,0.00,0.00,0.00,0.00,0.00,0.00,0.00,0.00,0.00,0.00,0.00,0.00,0.00,0.00,0.00,0.00,0.00],"weather_code":[0,1,2,2,1,1,0,0,0,0,0,0,0,0,0,0,0,0,3,3,1,0,0,0,0],"cloud_cover":[6,42,62,50,36,31,0,0,0,0,0,0,0,0,0,0,0,5,100,100,47,0,0,0,0],"wind_speed_10m":[14.4,18.8,22.1,25.5,29.0,31.3,35.1,37.2,34.7,33.0,30.1,24.5,18.5,13.1,11.4,9.9,8.7,7.2,7.6,8.2,9.7,9.4,9.2,7.7,5.8],"wind_direction_10m":[176,177,174,167,169,168,165,158,157,153,148,147,147,148,145,136,142,153,149,142,141,140,138,127,120],"wind_gusts_10m":[19.1,20.9,23.0,25.6,29.5,34.9,41.0,44.3,45.4,45.4,45.0,42.5,40.0,35.3,33.1,28.8,22.0,18.0,15.1,14.4,15.1,13.7,12.2,11.2,9.7],"uv_index":[5.65,7.25,7.30,8.35,8.00,6.80,5.65,3.75,1.95,0.55,0.00,0.00,0.00,0.00,0.00,0.00,0.00,0.00,0.00,0.00,0.00,0.60,2.00,3.90,5.85],"is_day":[1,1,1,1,1,1,1,1,1,1,0,0,0,0,0,0,0,0,0,0,1,1,1,1,1]},"daily_units":{"time":"unixtime","weather_code":"wmo code","temperature_2m_max":"°C","temperature_2m_min":"°C","apparent_temperature_max":"°C","apparent_temperature_min":"°C","sunrise":"unixtime","sunset":"unixtime","sunshine_duration":"s","uv_index_max":"","precipitation_sum":"mm","snowfall_sum":"cm","precipitation_hours":"h","precipitation_probability_max":"%","wind_speed_10m_max":"km/h","wind_gusts_10m_max":"km/h","wind_direction_10m_dominant":"°"},"daily":{"time":[1794002400,1794088800,1794175200,1794261600,1794348000,1794434400,1794520800],"weather_code":[51,3,3,3,1,3,3],"temperature_2m_max":[19.6,29.9,30.4,28.6,23.7,21.7,22.8],"temperature_2m_min":[14.7,13.2,18.9,18.1,18.0,16.7,15.1],"apparent_temperature_max":[16.9,30.3,29.4,28.5,25.6,20.1,21.3],"apparent_temperature_min":[11.0,11.0,16.9,17.4,18.4,14.0,13.3],"sunrise":[1794022809,1794109159,1794195510,1794281863,1794368217,1794454573,1794540931],"sunset":[1794071981,1794158438,1794244895,1794331353,1794417810,1794504268,1794590725],"sunshine_duration":[47038.99,46894.98,46938.16,46888.83,46840.26,47081.44,47337.36],"uv_index_max":[8.35,8.95,8.60,9.05,9.05,9.10,8.80],"precipitation_sum":[0.60,0.00,0.00,0.00,0.00,0.00,0.00],"snowfall_sum":[0.00,0.00,0.00,0.00,0.00,0.00,0.00],"precipitation_hours":[6.0,0.0,0.0,0.0,0.0,0.0,0.0],"precipitation_probability_max":[50,0,0,0,19,3,3],"wind_speed_10m_max":[37.2,12.2,14.9,16.4,14.9,29.7,32.8],"wind_gusts_10m_max":[45.4,33.1,24.8,31.7,19.4,42.1,51.8],"wind_direction_10m_dominant":[166,150,171,165,264,172,169]}})OM"
