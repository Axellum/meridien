// FICHIER GÉNÉRÉ par test/host/controle_python_modeles.py : ne pas modifier à la main.
// Réponse réelle d'Open-Meteo (noaa, Ottawa, requête complète du firmware + models=), voir donnees/LISEZMOI.md.
R"OM({"latitude":45.426113,"longitude":-75.67214,"generationtime_ms":1.1746883392333984,"utc_offset_seconds":-18000,"timezone":"America/Toronto","timezone_abbreviation":"GMT-5","elevation":68.0,"current_units":{"time":"unixtime","interval":"seconds","temperature_2m":"°C","apparent_temperature":"°C","is_day":"","precipitation":"mm","weather_code":"wmo code","cloud_cover":"%","wind_speed_10m":"km/h","wind_direction_10m":"°","wind_gusts_10m":"km/h","pressure_msl":"hPa","relative_humidity_2m":"%"},"current":{"time":1794040200,"interval":900,"temperature_2m":9.5,"apparent_temperature":7.1,"is_day":0,"precipitation":0.00,"weather_code":3,"cloud_cover":80,"wind_speed_10m":11.5,"wind_direction_10m":83,"wind_gusts_10m":31.3,"pressure_msl":1013.2,"relative_humidity_2m":86},"minutely_15_units":{"time":"unixtime","precipitation":"mm"},"minutely_15":{"time":[1794040200,1794041100,1794042000,1794042900,1794043800,1794044700,1794045600,1794046500,1794047400],"precipitation":[0.00,0.00,0.00,0.00,0.00,0.00,0.00,0.00,0.00]},"hourly_units":{"time":"unixtime","temperature_2m":"°C","apparent_temperature":"°C","relative_humidity_2m":"%","precipitation_probability":"%","precipitation":"mm","weather_code":"wmo code","cloud_cover":"%","wind_speed_10m":"km/h","wind_direction_10m":"°","wind_gusts_10m":"km/h","uv_index":"","is_day":""},"hourly":{"time":[1794038400,1794042000,1794045600,1794049200,1794052800,1794056400,1794060000,1794063600,1794067200,1794070800,1794074400,1794078000,1794081600,1794085200,1794088800,1794092400,1794096000,1794099600,1794103200,1794106800,1794110400,1794114000,1794117600,1794121200,1794124800],"temperature_2m":[9.7,9.0,7.6,7.3,6.9,7.7,8.3,8.7,8.9,9.0,9.2,9.2,9.3,9.3,9.3,9.0,8.6,8.4,8.1,8.0,7.6,7.0,6.9,6.8,6.7],"apparent_temperature":[7.4,6.4,4.3,4.2,4.0,6.0,6.1,6.5,7.4,7.8,8.3,7.8,7.9,8.3,8.2,7.2,6.5,6.6,6.2,6.2,5.4,4.5,4.4,4.4,4.2],"relative_humidity_2m":[85,86,82,84,86,90,87,87,86,86,86,88,89,91,92,89,88,90,90,91,91,93,90,89,89],"precipitation_probability":[4,7,10,13,12,10,9,9,9,10,11,10,11,14,17,12,11,8,7,8,7,5,3,2,2],"precipitation":[0.00,0.00,0.00,0.00,0.00,0.00,0.00,0.00,0.00,0.00,0.00,0.00,0.00,0.00,0.00,0.00,0.00,0.00,0.00,0.00,0.00,0.00,0.00,0.00,0.00],"weather_code":[3,2,2,2,1,2,1,3,3,3,3,3,3,3,3,3,3,3,3,3,3,3,3,3,3],"cloud_cover":[100,60,58,73,40,78,38,100,100,100,100,100,100,100,100,100,100,100,100,100,100,100,100,100,100],"wind_speed_10m":[11.3,11.6,13.4,12.0,11.1,4.7,9.0,8.7,4.9,2.5,0.5,4.8,4.7,3.5,4.2,7.4,9.1,6.7,6.6,6.4,8.8,10.0,9.4,7.8,8.4],"wind_direction_10m":[87,96,96,88,75,104,75,65,86,95,59,271,288,308,304,345,340,337,344,300,303,309,306,317,304],"wind_gusts_10m":[29.2,29.2,38.2,36.7,29.5,24.5,20.5,23.4,16.9,10.1,11.2,14.0,15.5,15.1,18.0,23.8,23.4,19.8,20.2,15.8,17.6,20.5,23.0,20.9,20.2],"uv_index":[0.00,0.00,0.00,0.00,0.00,0.05,0.10,0.25,0.55,0.90,0.50,0.55,0.70,0.40,0.05,0.00,0.00,0.00,0.00,0.00,0.00,0.00,0.00,0.00,0.00],"is_day":[0,0,0,0,1,1,1,1,1,1,1,1,1,1,0,0,0,0,0,0,0,0,0,0,0]},"daily_units":{"time":"unixtime","weather_code":"wmo code","temperature_2m_max":"°C","temperature_2m_min":"°C","apparent_temperature_max":"°C","apparent_temperature_min":"°C","sunrise":"unixtime","sunset":"unixtime","sunshine_duration":"s","uv_index_max":"","precipitation_sum":"mm","snowfall_sum":"cm","precipitation_hours":"h","precipitation_probability_max":"%","wind_speed_10m_max":"km/h","wind_gusts_10m_max":"km/h","wind_direction_10m_dominant":"°"},"daily":{"time":[1794027600,1794114000,1794200400,1794286800,1794373200,1794459600,1794546000],"weather_code":[3,51,51,51,71,71,73],"temperature_2m_max":[11.5,7.9,8.9,10.3,10.0,4.9,4.1],"temperature_2m_min":[6.9,6.1,4.9,4.2,4.0,-0.3,-0.9],"apparent_temperature_max":[10.4,5.1,4.9,6.4,7.7,0.6,-1.5],"apparent_temperature_min":[4.0,2.7,-0.1,1.0,0.1,-4.9,-5.9],"sunrise":[1794052234,1794138719,1794225203,1794311688,1794398172,1794484656,1794571139],"sunset":[1794087704,1794174027,1794260353,1794346680,1794433009,1794519340,1794605674],"sunshine_duration":[6043.00,4516.98,9000.33,24578.59,22423.16,33150.43,27624.80],"uv_index_max":[0.90,2.70,0.85,1.80,2.20,2.35,1.65],"precipitation_sum":[0.00,0.40,0.40,0.10,3.40,3.70,2.50],"snowfall_sum":[0.00,0.00,0.00,0.00,0.14,0.28,1.12],"precipitation_hours":[0.0,1.0,4.0,1.0,6.0,5.0,7.0],"precipitation_probability_max":[17,36,36,31,8,6,9],"wind_speed_10m_max":[13.4,17.5,24.3,18.9,18.7,15.6,22.2],"wind_gusts_10m_max":[38.2,34.2,46.4,42.5,31.7,38.2,45.7],"wind_direction_10m_dominant":[56,264,289,262,31,15,37]}})OM"
