// FICHIER GÉNÉRÉ par test/host/controle_python_modeles.py : ne pas modifier à la main.
// Réponse réelle d'Open-Meteo (meteofrance, Lyon, requête complète du firmware + models=), voir donnees/LISEZMOI.md.
R"OM({"latitude":45.75,"longitude":4.8500004,"generationtime_ms":2.407670021057129,"utc_offset_seconds":3600,"timezone":"Europe/Paris","timezone_abbreviation":"GMT+1","elevation":176.0,"current_units":{"time":"unixtime","interval":"seconds","temperature_2m":"°C","apparent_temperature":"°C","is_day":"","precipitation":"mm","weather_code":"wmo code","cloud_cover":"%","wind_speed_10m":"km/h","wind_direction_10m":"°","wind_gusts_10m":"km/h","pressure_msl":"hPa","relative_humidity_2m":"%"},"current":{"time":1794040200,"interval":900,"temperature_2m":8.7,"apparent_temperature":5.7,"is_day":1,"precipitation":0.00,"weather_code":1,"cloud_cover":47,"wind_speed_10m":9.7,"wind_direction_10m":321,"wind_gusts_10m":17.3,"pressure_msl":1026.1,"relative_humidity_2m":78},"minutely_15_units":{"time":"unixtime","precipitation":"mm"},"minutely_15":{"time":[1794040200,1794041100,1794042000,1794042900,1794043800,1794044700,1794045600,1794046500,1794047400],"precipitation":[0.00,0.00,0.00,0.00,0.00,0.00,0.00,0.00,0.00]},"hourly_units":{"time":"unixtime","temperature_2m":"°C","apparent_temperature":"°C","relative_humidity_2m":"%","precipitation_probability":"undefined","precipitation":"mm","weather_code":"wmo code","cloud_cover":"%","wind_speed_10m":"km/h","wind_direction_10m":"°","wind_gusts_10m":"km/h","uv_index":"undefined","is_day":""},"hourly":{"time":[1794038400,1794042000,1794045600,1794049200,1794052800,1794056400,1794060000,1794063600,1794067200,1794070800,1794074400,1794078000,1794081600,1794085200,1794088800,1794092400,1794096000,1794099600,1794103200,1794106800,1794110400,1794114000,1794117600,1794121200,1794124800],"temperature_2m":[8.5,9.1,9.7,10.3,10.8,11.3,11.4,11.1,10.4,9.9,8.9,8.1,7.3,6.7,6.3,5.4,4.8,4.3,3.7,2.1,1.2,1.9,2.5,2.9,3.5],"apparent_temperature":[5.6,6.0,7.6,8.5,9.0,9.4,9.3,8.8,8.0,7.9,6.9,6.2,5.2,4.9,4.4,3.0,2.5,1.8,1.1,-0.6,-1.5,-0.5,0.3,1.0,1.6],"relative_humidity_2m":[80,76,73,71,69,66,66,68,70,71,75,77,77,80,80,81,85,85,86,96,98,98,97,97,96],"precipitation_probability":[null,null,null,null,null,null,null,null,null,null,null,null,null,null,null,null,null,null,null,null,null,null,null,null,null],"precipitation":[0.00,0.00,0.00,0.00,0.00,0.00,0.00,0.00,0.00,0.00,0.00,0.00,0.00,0.00,0.00,0.00,0.00,0.00,0.00,0.00,0.00,0.00,0.00,0.00,0.00],"weather_code":[3,0,2,3,2,1,3,3,1,3,3,3,3,2,1,2,3,3,0,2,3,3,3,3,3],"cloud_cover":[99,3,63,99,77,38,97,85,33,100,100,100,98,63,43,71,100,84,0,73,100,100,100,100,100],"wind_speed_10m":[8.7,9.9,6.9,1.8,3.3,5.2,6.7,7.6,8.2,5.2,4.7,4.3,4.6,2.2,1.8,4.5,4.4,5.2,5.0,5.6,4.7,4.0,2.9,1.4,2.2],"wind_direction_10m":[318,314,309,360,85,70,65,71,52,34,356,318,18,351,90,29,35,56,30,50,32,27,360,360,90],"wind_gusts_10m":[17.6,18.7,15.1,9.4,11.9,14.0,15.6,16.9,15.8,14.4,9.0,6.5,5.8,5.0,2.5,5.0,6.1,6.1,6.5,8.6,7.9,9.0,7.2,6.8,6.1],"uv_index":[null,null,null,null,null,null,null,null,null,null,null,null,null,null,null,null,null,null,null,null,null,null,null,null,null],"is_day":[1,1,1,1,1,1,1,1,1,0,0,0,0,0,0,0,0,0,0,0,0,0,0,1,1]},"daily_units":{"time":"unixtime","weather_code":"wmo code","temperature_2m_max":"°C","temperature_2m_min":"°C","apparent_temperature_max":"°C","apparent_temperature_min":"°C","sunrise":"unixtime","sunset":"unixtime","sunshine_duration":"s","uv_index_max":"undefined","precipitation_sum":"mm","snowfall_sum":"cm","precipitation_hours":"h","precipitation_probability_max":"undefined","wind_speed_10m_max":"km/h","wind_gusts_10m_max":"km/h","wind_direction_10m_dominant":"°"},"daily":{"time":[1794006000,1794092400,1794178800,1794265200,1794351600,1794438000,1794524400],"weather_code":[3,3,51,51,null,null,null],"temperature_2m_max":[11.4,15.2,16.2,17.9,null,null,null],"temperature_2m_min":[5.4,1.2,6.2,11.4,null,null,null],"apparent_temperature_max":[9.4,13.2,12.4,18.1,null,null,null],"apparent_temperature_min":[4.4,-1.5,5.0,11.6,null,null,null],"sunrise":[1794032936,1794119422,1794205908,1794292393,1794378878,1794465363,1794551847],"sunset":[1794068349,1794154671,1794240995,1794327321,1794413649,1794499978,1794586310],"sunshine_duration":[22805.01,28147.04,17317.90,21715.54,null,null,null],"uv_index_max":[null,null,null,null,null,null,null],"precipitation_sum":[0.00,0.00,0.80,0.70,null,null,null],"snowfall_sum":[0.00,0.00,0.00,0.00,null,null,null],"precipitation_hours":[0.0,0.0,4.0,4.0,3.0,0.0,0.0],"precipitation_probability_max":[null,null,null,null,null,null,null],"wind_speed_10m_max":[9.9,12.0,31.3,27.0,null,null,null],"wind_gusts_10m_max":[18.7,23.8,59.0,47.5,null,null,null],"wind_direction_10m_dominant":[353,40,188,181,null,null,null]}})OM"
