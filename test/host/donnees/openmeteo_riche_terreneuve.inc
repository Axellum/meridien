// FICHIER GÉNÉRÉ par test/host/controle_python_riche.py : ne pas modifier à la main.
// Réponse réelle d'Open-Meteo (terreneuve, requête du firmware), voir donnees/LISEZMOI.md.
R"OM({"latitude":47.557117,"longitude":-52.697357,"generationtime_ms":0.7014274597167969,"utc_offset_seconds":-12600,"timezone":"America/St_Johns","timezone_abbreviation":"GMT-3:30","elevation":4.0,"current_units":{"time":"unixtime","interval":"seconds","temperature_2m":"°C","apparent_temperature":"°C","is_day":"","precipitation":"mm","weather_code":"wmo code","cloud_cover":"%","wind_speed_10m":"km/h","wind_direction_10m":"°","wind_gusts_10m":"km/h","pressure_msl":"hPa","relative_humidity_2m":"%"},"current":{"time":1794006000,"interval":900,"temperature_2m":10.6,"apparent_temperature":7.1,"is_day":0,"precipitation":0.00,"weather_code":3,"cloud_cover":100,"wind_speed_10m":24.7,"wind_direction_10m":246,"wind_gusts_10m":46.4,"pressure_msl":1013.8,"relative_humidity_2m":98},"minutely_15_units":{"time":"unixtime","precipitation":"mm"},"minutely_15":{"time":[1794007800,1794008700,1794009600,1794010500,1794011400,1794012300,1794013200,1794014100,1794015000],"precipitation":[0.00,0.00,0.00,0.00,0.00,0.00,0.00,0.00,0.00]},"hourly_units":{"time":"unixtime","temperature_2m":"°C","apparent_temperature":"°C","relative_humidity_2m":"%","precipitation_probability":"%","precipitation":"mm","weather_code":"wmo code","cloud_cover":"%","wind_speed_10m":"km/h","wind_direction_10m":"°","wind_gusts_10m":"km/h","uv_index":"","is_day":""},"hourly":{"time":[1794007800,1794011400,1794015000,1794018600,1794022200,1794025800,1794029400,1794033000,1794036600,1794040200,1794043800,1794047400,1794051000,1794054600,1794058200,1794061800,1794065400,1794069000,1794072600,1794076200,1794079800,1794083400,1794087000,1794090600,1794094200],"temperature_2m":[10.6,10.8,10.7,10.7,10.8,11.0,11.0,11.2,10.8,10.7,10.6,10.7,11.0,11.3,11.4,11.4,11.4,11.1,6.1,5.6,5.4,4.5,3.8,3.6,3.4],"apparent_temperature":[7.1,7.3,7.4,7.8,7.9,8.1,8.2,8.8,8.4,8.4,8.5,8.4,8.3,7.7,7.6,7.7,8.2,8.2,1.4,0.9,0.6,-0.9,-1.5,-1.6,-1.7],"relative_humidity_2m":[98,96,98,98,98,97,98,98,98,99,98,98,98,98,97,97,96,95,94,92,89,90,91,92,90],"precipitation_probability":[1,2,1,0,0,0,0,4,28,61,84,88,83,78,76,75,69,57,41,27,17,8,2,0,0],"precipitation":[0.00,0.00,0.00,0.00,0.00,0.00,0.00,0.00,0.00,0.50,5.60,0.20,0.00,0.00,0.20,1.40,0.10,0.00,0.10,0.00,0.00,0.00,0.00,0.00,0.00],"weather_code":[3,3,3,3,3,3,3,3,3,53,81,51,3,3,51,80,51,3,51,3,3,3,3,3,3],"cloud_cover":[100,97,98,97,99,96,95,92,99,100,99,99,100,100,100,100,100,100,100,99,100,100,100,100,100],"wind_speed_10m":[24.7,24.6,22.9,21.1,20.8,21.1,20.2,18.2,17.5,16.7,14.4,16.2,19.5,26.4,27.4,27.6,23.0,20.3,23.8,22.6,22.8,25.5,24.4,23.3,22.6],"wind_direction_10m":[246,249,248,250,252,255,256,252,253,251,260,255,253,254,267,267,284,295,336,336,339,347,352,356,5],"wind_gusts_10m":[46.4,48.2,46.4,43.6,39.2,39.6,39.2,37.1,33.8,32.8,32.4,29.9,36.4,48.6,51.8,51.8,51.8,45.4,51.1,47.5,46.1,52.2,51.5,49.3,47.5],"uv_index":[0.00,0.00,0.00,0.00,0.00,0.00,0.00,0.00,0.00,0.00,0.00,0.00,0.00,0.10,0.30,0.20,0.25,0.65,0.40,0.25,0.25,0.05,0.00,0.00,0.00],"is_day":[0,0,0,0,0,0,0,0,0,0,0,0,1,1,1,1,1,1,1,1,1,1,0,0,0]},"daily_units":{"time":"unixtime","weather_code":"wmo code","temperature_2m_max":"°C","temperature_2m_min":"°C","apparent_temperature_max":"°C","apparent_temperature_min":"°C","sunrise":"unixtime","sunset":"unixtime","sunshine_duration":"s","uv_index_max":"","precipitation_sum":"mm","snowfall_sum":"cm","precipitation_hours":"h","precipitation_probability_max":"%","wind_speed_10m_max":"km/h","wind_gusts_10m_max":"km/h","wind_direction_10m_dominant":"°"},"daily":{"time":[1793935800,1794022200,1794108600,1794195000,1794281400,1794367800,1794454200],"weather_code":[3,81,53,55,61,61,51],"temperature_2m_max":[10.8,11.4,4.8,10.7,5.3,8.6,6.7],"temperature_2m_min":[2.9,3.3,3.0,4.4,3.1,3.5,2.6],"apparent_temperature_max":[7.8,8.8,-0.4,9.4,3.2,3.1,1.4],"apparent_temperature_min":[-1.5,-1.7,-1.9,-0.3,1.0,-1.0,-1.2],"sunrise":[1793960541,1794047033,1794133525,1794220016,1794306507,1794392998,1794479489],"sunset":[1793995559,1794081874,1794168191,1794254509,1794340830,1794427152,1794513476],"sunshine_duration":[0.00,0.00,1815.49,10582.17,8876.00,13471.01,28345.58],"uv_index_max":[0.95,0.65,1.20,1.75,2.05,1.35,1.50],"precipitation_sum":[0.00,8.10,3.30,7.40,2.90,2.20,1.50],"snowfall_sum":[0.00,0.00,0.00,0.00,0.00,0.00,0.00],"precipitation_hours":[0.0,7.0,9.0,15.0,5.0,4.0,9.0],"precipitation_probability_max":[12,88,88,96,71,71,22],"wind_speed_10m_max":[25.1,27.6,27.0,25.8,12.3,26.7,22.1],"wind_gusts_10m_max":[51.8,52.2,52.9,49.3,25.2,58.7,50.8],"wind_direction_10m_dominant":[208,301,104,160,131,249,232]}})OM"
