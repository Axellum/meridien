// FICHIER GÉNÉRÉ par test/host/controle_python_modeles.py : ne pas modifier à la main.
// Réponse réelle d'Open-Meteo (knmi, Luxembourg, requête complète du firmware + models=), voir donnees/LISEZMOI.md.
R"OM({"latitude":49.612,"longitude":6.119,"generationtime_ms":3.841996192932129,"utc_offset_seconds":3600,"timezone":"Europe/Luxembourg","timezone_abbreviation":"GMT+1","elevation":321.0,"current_units":{"time":"unixtime","interval":"seconds","temperature_2m":"°C","apparent_temperature":"°C","is_day":"","precipitation":"mm","weather_code":"wmo code","cloud_cover":"%","wind_speed_10m":"km/h","wind_direction_10m":"°","wind_gusts_10m":"km/h","pressure_msl":"hPa","relative_humidity_2m":"%"},"current":{"time":1794040200,"interval":900,"temperature_2m":4.9,"apparent_temperature":2.8,"is_day":1,"precipitation":0.00,"weather_code":3,"cloud_cover":100,"wind_speed_10m":4.7,"wind_direction_10m":153,"wind_gusts_10m":10.4,"pressure_msl":1024.8,"relative_humidity_2m":92},"minutely_15_units":{"time":"unixtime","precipitation":"mm"},"minutely_15":{"time":[1794040200,1794041100,1794042000,1794042900,1794043800,1794044700,1794045600,1794046500,1794047400],"precipitation":[0.00,0.00,0.00,0.00,0.00,0.00,0.00,0.00,0.00]},"hourly_units":{"time":"unixtime","temperature_2m":"°C","apparent_temperature":"°C","relative_humidity_2m":"%","precipitation_probability":"%","precipitation":"mm","weather_code":"wmo code","cloud_cover":"%","wind_speed_10m":"km/h","wind_direction_10m":"°","wind_gusts_10m":"km/h","uv_index":"","is_day":""},"hourly":{"time":[1794038400,1794042000,1794045600,1794049200,1794052800,1794056400,1794060000,1794063600,1794067200,1794070800,1794074400,1794078000,1794081600,1794085200,1794088800,1794092400,1794096000,1794099600,1794103200,1794106800,1794110400,1794114000,1794117600,1794121200,1794124800],"temperature_2m":[4.8,5.0,4.9,5.0,4.9,5.0,4.9,5.0,4.9,4.9,4.9,5.1,5.4,5.4,5.5,4.7,5.1,5.0,5.0,5.0,5.0,5.1,5.3,5.5,5.9],"apparent_temperature":[2.8,2.6,2.4,2.7,2.5,2.7,3.0,3.0,2.8,2.7,2.7,3.4,4.0,3.9,3.9,2.2,3.2,3.1,3.1,2.9,3.0,3.0,3.5,3.7,4.3],"relative_humidity_2m":[93,92,93,92,94,96,98,98,98,98,99,99,97,96,95,96,98,99,99,99,99,99,98,96,94],"precipitation_probability":[3,0,0,0,0,0,0,0,2,4,6,6,5,4,3,1,0,1,2,4,7,10,12,12,10],"precipitation":[0.00,0.00,0.00,0.00,0.00,0.00,0.00,0.00,0.10,0.00,0.00,0.00,0.00,0.00,0.00,0.00,0.00,0.00,0.00,0.00,0.00,0.00,0.00,0.00,0.00],"weather_code":[3,3,3,3,3,3,45,45,51,45,45,45,3,3,0,3,3,45,45,45,45,45,45,3,3],"cloud_cover":[100,100,100,100,100,100,100,100,100,100,100,100,100,100,7,100,100,100,100,100,100,100,100,100,100],"wind_speed_10m":[3.6,6.1,7.2,5.4,6.8,6.1,4.7,5.0,5.4,6.1,6.5,3.2,1.1,2.2,2.5,7.6,4.3,4.3,4.7,5.4,5.0,5.8,4.0,4.0,2.9],"wind_direction_10m":[136,169,165,161,185,179,175,165,155,159,172,192,250,153,346,144,152,157,152,155,169,157,157,129,110],"wind_gusts_10m":[8.3,12.6,14.0,15.1,14.4,13.7,12.2,10.4,10.4,13.0,14.0,12.6,7.6,7.9,3.2,11.9,13.0,9.7,9.7,10.4,11.9,11.5,11.2,9.0,7.9],"uv_index":[0.30,0.90,1.50,1.90,2.05,1.70,1.30,0.70,0.15,0.00,0.00,0.00,0.00,0.00,0.00,0.00,0.00,0.00,0.00,0.00,0.00,0.00,0.00,0.00,0.35],"is_day":[1,1,1,1,1,1,1,1,1,0,0,0,0,0,0,0,0,0,0,0,0,0,0,1,1]},"daily_units":{"time":"unixtime","weather_code":"wmo code","temperature_2m_max":"°C","temperature_2m_min":"°C","apparent_temperature_max":"°C","apparent_temperature_min":"°C","sunrise":"unixtime","sunset":"unixtime","sunshine_duration":"s","uv_index_max":"","precipitation_sum":"mm","snowfall_sum":"cm","precipitation_hours":"h","precipitation_probability_max":"%","wind_speed_10m_max":"km/h","wind_gusts_10m_max":"km/h","wind_direction_10m_dominant":"°"},"daily":{"time":[1794006000,1794092400,1794178800,1794265200,1794351600,1794438000,1794524400],"weather_code":[51,45,45,53,80,3,3],"temperature_2m_max":[5.6,8.9,7.5,8.6,14.0,13.2,10.4],"temperature_2m_min":[4.2,3.2,2.3,4.8,8.3,7.7,1.6],"apparent_temperature_max":[4.0,7.1,5.2,6.5,12.9,13.1,4.9],"apparent_temperature_min":[2.1,0.5,-0.6,2.2,6.5,6.2,-1.4],"sunrise":[1794033235,1794119734,1794206233,1794292732,1794379230,1794465728,1794552225],"sunset":[1794067436,1794153745,1794240056,1794326369,1794412684,1794499001,1794585320],"sunshine_duration":[412.59,13303.47,2759.51,0.00,0.00,0.00,31787.64],"uv_index_max":[2.05,2.00,2.05,1.35,0.30,1.50,1.80],"precipitation_sum":[1.00,0.00,0.00,3.70,9.60,0.00,0.00],"snowfall_sum":[0.00,0.00,0.00,0.00,0.00,0.00,0.00],"precipitation_hours":[6.0,0.0,0.0,17.0,12.0,0.0,0.0],"precipitation_probability_max":[22,12,8,29,44,76,75],"wind_speed_10m_max":[7.2,9.0,7.9,10.3,14.3,14.0,20.5],"wind_gusts_10m_max":[15.1,15.8,16.9,21.2,27.0,25.9,41.4],"wind_direction_10m_dominant":[164,128,82,99,185,218,25]}})OM"
