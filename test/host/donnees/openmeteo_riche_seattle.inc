// FICHIER GÉNÉRÉ par test/host/controle_python_riche.py : ne pas modifier à la main.
// Réponse réelle d'Open-Meteo (seattle, requête du firmware), voir donnees/LISEZMOI.md.
R"OM({"latitude":47.595562,"longitude":-122.32443,"generationtime_ms":1.8919706344604492,"utc_offset_seconds":-28800,"timezone":"America/Los_Angeles","timezone_abbreviation":"GMT-8","elevation":59.0,"current_units":{"time":"unixtime","interval":"seconds","temperature_2m":"°C","apparent_temperature":"°C","is_day":"","precipitation":"mm","weather_code":"wmo code","cloud_cover":"%","wind_speed_10m":"km/h","wind_direction_10m":"°","wind_gusts_10m":"km/h","pressure_msl":"hPa","relative_humidity_2m":"%"},"current":{"time":1794006000,"interval":900,"temperature_2m":11.5,"apparent_temperature":10.3,"is_day":1,"precipitation":0.80,"weather_code":63,"cloud_cover":100,"wind_speed_10m":8.0,"wind_direction_10m":175,"wind_gusts_10m":29.2,"pressure_msl":1016.7,"relative_humidity_2m":89},"minutely_15_units":{"time":"unixtime","precipitation":"mm"},"minutely_15":{"time":[1794006000,1794006900,1794007800,1794008700,1794009600,1794010500,1794011400,1794012300,1794013200],"precipitation":[0.80,0.30,0.30,0.20,0.20,0.10,0.00,0.10,0.00]},"hourly_units":{"time":"unixtime","temperature_2m":"°C","apparent_temperature":"°C","relative_humidity_2m":"%","precipitation_probability":"%","precipitation":"mm","weather_code":"wmo code","cloud_cover":"%","wind_speed_10m":"km/h","wind_direction_10m":"°","wind_gusts_10m":"km/h","uv_index":"","is_day":""},"hourly":{"time":[1794006000,1794009600,1794013200,1794016800,1794020400,1794024000,1794027600,1794031200,1794034800,1794038400,1794042000,1794045600,1794049200,1794052800,1794056400,1794060000,1794063600,1794067200,1794070800,1794074400,1794078000,1794081600,1794085200,1794088800,1794092400],"temperature_2m":[11.5,11.4,11.9,12.0,12.0,12.0,11.4,11.0,10.3,9.3,8.7,8.1,7.8,7.7,7.8,7.7,9.0,10.0,10.9,11.7,12.9,14.7,16.2,16.3,16.2],"apparent_temperature":[10.3,10.2,9.0,9.9,9.8,9.6,8.6,8.7,9.0,7.6,6.7,6.2,5.6,5.8,6.7,6.1,7.8,9.1,10.1,11.4,12.5,14.7,15.7,15.0,14.7],"relative_humidity_2m":[89,93,93,93,92,89,89,89,90,89,88,86,87,86,89,86,89,88,88,89,87,85,82,78,74],"precipitation_probability":[62,48,35,36,7,4,2,3,3,3,2,1,2,3,3,4,4,5,6,6,5,4,4,5,6],"precipitation":[1.70,1.00,0.20,0.10,0.00,0.00,0.00,0.00,0.00,0.00,0.00,0.00,0.00,0.00,0.00,0.00,0.00,0.00,0.00,0.00,0.00,0.00,0.00,0.00,0.00],"weather_code":[61,55,51,51,3,3,3,2,3,0,0,0,3,3,3,3,3,3,3,3,3,3,3,3,3],"cloud_cover":[100,100,100,100,100,100,100,50,100,9,1,9,100,97,100,100,100,100,100,100,87,82,100,100,94],"wind_speed_10m":[8.0,9.4,21.5,16.7,16.9,17.3,18.5,14.2,6.6,7.9,8.3,6.1,7.9,5.8,1.0,3.3,3.4,3.2,3.8,2.3,4.5,5.1,10.5,14.9,14.0],"wind_direction_10m":[175,162,204,197,185,196,202,185,177,165,162,136,125,165,300,34,332,48,91,273,269,204,180,171,176],"wind_gusts_10m":[29.2,38.5,47.5,42.1,42.8,42.1,34.9,30.6,22.3,14.8,15.8,7.9,9.4,12.2,5.3,3.4,5.7,3.2,3.6,3.2,10.8,18.7,29.5,41.8,41.8],"uv_index":[0.10,0.05,0.00,0.00,0.00,0.00,0.00,0.00,0.00,0.00,0.00,0.00,0.00,0.00,0.00,0.00,0.00,0.10,0.65,1.05,0.95,0.45,0.30,0.40,0.95],"is_day":[1,1,0,0,0,0,0,0,0,0,0,0,0,0,0,0,0,1,1,1,1,1,1,1,1]},"daily_units":{"time":"unixtime","weather_code":"wmo code","temperature_2m_max":"°C","temperature_2m_min":"°C","apparent_temperature_max":"°C","apparent_temperature_min":"°C","sunrise":"unixtime","sunset":"unixtime","sunshine_duration":"s","uv_index_max":"","precipitation_sum":"mm","snowfall_sum":"cm","precipitation_hours":"h","precipitation_probability_max":"%","wind_speed_10m_max":"km/h","wind_gusts_10m_max":"km/h","wind_direction_10m_dominant":"°"},"daily":{"time":[1793952000,1794038400,1794124800,1794211200,1794297600,1794384000,1794470400],"weather_code":[61,63,61,3,63,3,3],"temperature_2m_max":[12.2,16.4,12.4,12.3,10.3,14.9,15.3],"temperature_2m_min":[9.0,7.4,7.2,6.1,8.0,9.1,8.7],"apparent_temperature_max":[10.3,15.7,8.7,9.2,9.2,13.8,12.6],"apparent_temperature_min":[6.1,5.6,4.3,4.6,5.7,7.5,6.3],"sunrise":[1793977275,1794063767,1794150259,1794236751,1794323242,1794409733,1794496223],"sunset":[1794012247,1794098562,1794184879,1794271198,1794357518,1794443841,1794530166],"sunshine_duration":[0.00,13560.63,33070.89,30581.33,0.00,30566.00,30480.90],"uv_index_max":[0.60,1.05,2.20,2.15,0.35,1.90,2.00],"precipitation_sum":[5.10,6.50,4.65,0.00,8.10,0.00,0.00],"snowfall_sum":[0.00,0.00,0.00,0.00,0.00,0.00,0.00],"precipitation_hours":[12.0,3.0,9.0,0.0,11.0,0.0,0.0],"precipitation_probability_max":[62,100,97,71,88,37,40],"wind_speed_10m_max":[21.5,28.8,31.3,8.7,11.5,6.1,9.4],"wind_gusts_10m_max":[47.5,69.8,66.6,11.2,15.8,4.7,14.8],"wind_direction_10m_dominant":[167,182,200,167,171,149,166]}})OM"
