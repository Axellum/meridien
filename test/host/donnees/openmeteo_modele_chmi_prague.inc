// FICHIER GÉNÉRÉ par test/host/controle_python_modeles.py : ne pas modifier à la main.
// Réponse réelle d'Open-Meteo (chmi, Prague, requête complète du firmware + models=), voir donnees/LISEZMOI.md.
R"OM({"latitude":50.091164,"longitude":14.42027,"generationtime_ms":90.27290344238281,"utc_offset_seconds":3600,"timezone":"Europe/Prague","timezone_abbreviation":"GMT+1","elevation":205.0,"current_units":{"time":"unixtime","interval":"seconds","temperature_2m":"°C","apparent_temperature":"°C","is_day":"","precipitation":"mm","weather_code":"wmo code","cloud_cover":"%","wind_speed_10m":"km/h","wind_direction_10m":"°","wind_gusts_10m":"km/h","pressure_msl":"hPa","relative_humidity_2m":"%"},"current":{"time":1794040200,"interval":900,"temperature_2m":1.6,"apparent_temperature":-1.6,"is_day":1,"precipitation":0.00,"weather_code":0,"cloud_cover":18,"wind_speed_10m":6.5,"wind_direction_10m":98,"wind_gusts_10m":11.9,"pressure_msl":1029.1,"relative_humidity_2m":84},"minutely_15_units":{"time":"unixtime","precipitation":"mm"},"minutely_15":{"time":[1794040200,1794041100,1794042000,1794042900,1794043800,1794044700,1794045600,1794046500,1794047400],"precipitation":[0.00,0.00,0.00,0.00,0.00,0.00,0.00,0.00,0.00]},"hourly_units":{"time":"unixtime","temperature_2m":"°C","apparent_temperature":"°C","relative_humidity_2m":"%","precipitation_probability":"%","precipitation":"mm","weather_code":"wmo code","cloud_cover":"%","wind_speed_10m":"km/h","wind_direction_10m":"°","wind_gusts_10m":"km/h","uv_index":"undefined","is_day":""},"hourly":{"time":[1794038400,1794042000,1794045600,1794049200,1794052800,1794056400,1794060000,1794063600,1794067200,1794070800,1794074400,1794078000,1794081600,1794085200,1794088800,1794092400,1794096000,1794099600,1794103200,1794106800,1794110400,1794114000,1794117600,1794121200,1794124800],"temperature_2m":[0.6,2.6,5.1,6.9,8.4,9.3,9.7,8.4,6.0,3.8,2.4,0.9,-0.0,-0.9,-1.6,-2.1,-2.5,-2.9,-3.3,-3.6,-3.9,-3.9,-3.5,-3.0,-1.9],"apparent_temperature":[-2.6,-0.6,1.9,4.0,5.8,6.9,7.4,5.9,3.2,0.3,-1.1,-2.2,-3.2,-4.0,-4.7,-5.1,-5.6,-6.2,-6.6,-6.9,-7.0,-6.9,-6.6,-5.9,-4.9],"relative_humidity_2m":[88,81,76,71,64,58,55,62,70,74,77,84,88,91,93,95,95,95,95,94,95,96,96,96,87],"precipitation_probability":[0,0,0,0,0,0,0,0,0,0,0,0,0,0,0,0,0,0,0,0,0,0,0,0,0],"precipitation":[0.00,0.00,0.00,0.00,0.00,0.00,0.00,0.00,0.00,0.00,0.00,0.00,0.00,0.00,0.00,0.00,0.00,0.00,0.00,0.00,0.00,0.00,0.00,0.00,0.00],"weather_code":[1,0,0,0,0,0,0,0,0,0,0,0,0,0,0,0,0,0,0,0,0,2,3,3,3],"cloud_cover":[38,1,0,2,0,0,0,0,0,0,0,0,0,0,0,0,0,0,0,9,9,55,80,98,80],"wind_speed_10m":[6.1,6.8,9.0,7.9,5.4,3.2,2.2,3.6,5.4,8.6,7.6,5.4,5.0,4.7,4.3,3.6,3.6,4.7,4.3,4.0,2.5,1.8,2.9,1.8,2.2],"wind_direction_10m":[97,98,92,86,111,121,149,171,182,159,183,158,128,125,121,118,112,95,113,93,88,356,47,360,332],"wind_gusts_10m":[11.5,12.6,15.8,16.2,14.8,11.9,8.6,6.1,6.8,11.5,11.5,10.4,6.5,6.8,5.8,5.4,4.7,5.8,6.1,5.4,5.0,1.4,3.2,3.6,6.5],"uv_index":[null,null,null,null,null,null,null,null,null,null,null,null,null,null,null,null,null,null,null,null,null,null,null,null,null],"is_day":[1,1,1,1,1,1,1,1,0,0,0,0,0,0,0,0,0,0,0,0,0,0,0,1,1]},"daily_units":{"time":"unixtime","weather_code":"wmo code","temperature_2m_max":"°C","temperature_2m_min":"°C","apparent_temperature_max":"°C","apparent_temperature_min":"°C","sunrise":"unixtime","sunset":"unixtime","sunshine_duration":"s","uv_index_max":"undefined","precipitation_sum":"mm","snowfall_sum":"cm","precipitation_hours":"h","precipitation_probability_max":"%","wind_speed_10m_max":"km/h","wind_gusts_10m_max":"km/h","wind_direction_10m_dominant":"°"},"daily":{"time":[1794006000,1794092400,1794178800,1794265200,1794351600,1794438000,1794524400],"weather_code":[45,3,45,53,80,80,53],"temperature_2m_max":[9.7,3.2,5.9,6.4,6.6,14.9,9.6],"temperature_2m_min":[-2.1,-4.0,-2.3,-1.0,-1.0,5.2,1.9],"apparent_temperature_max":[7.4,0.5,2.9,4.3,3.9,13.9,6.8],"apparent_temperature_min":[-4.7,-7.0,-5.0,-3.3,-4.1,4.1,-0.4],"sunrise":[1794031323,1794117824,1794204325,1794290825,1794377325,1794463824,1794550323],"sunset":[1794065364,1794151671,1794237980,1794324291,1794410604,1794496919,1794583236],"sunshine_duration":[26736.00,3975.00,27718.00,19637.01,0.00,31100.34,0.00],"uv_index_max":[null,null,null,null,null,null,null],"precipitation_sum":[0.00,0.00,0.00,1.10,4.10,6.30,8.80],"snowfall_sum":[0.00,0.00,0.00,0.00,0.00,0.00,0.00],"precipitation_hours":[0.0,0.0,0.0,2.0,10.0,6.0,14.0],"precipitation_probability_max":[0,4,8,31,14,25,51],"wind_speed_10m_max":[9.4,4.7,6.8,6.7,6.5,10.0,18.8],"wind_gusts_10m_max":[16.6,6.5,10.8,15.8,16.2,21.6,42.1],"wind_direction_10m_dominant":[116,79,77,133,97,171,348]}})OM"
