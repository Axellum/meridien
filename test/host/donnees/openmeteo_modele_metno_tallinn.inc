// FICHIER GÉNÉRÉ par test/host/controle_python_modeles.py : ne pas modifier à la main.
// Réponse réelle d'Open-Meteo (metno, Tallinn, requête complète du firmware + models=), voir donnees/LISEZMOI.md.
R"OM({"latitude":59.439518,"longitude":24.75708,"generationtime_ms":0.583648681640625,"utc_offset_seconds":7200,"timezone":"Europe/Tallinn","timezone_abbreviation":"GMT+2","elevation":10.0,"current_units":{"time":"unixtime","interval":"seconds","temperature_2m":"°C","apparent_temperature":"°C","is_day":"","precipitation":"mm","weather_code":"wmo code","cloud_cover":"%","wind_speed_10m":"km/h","wind_direction_10m":"°","wind_gusts_10m":"km/h","pressure_msl":"hPa","relative_humidity_2m":"%"},"current":{"time":1794040200,"interval":900,"temperature_2m":7.2,"apparent_temperature":2.3,"is_day":1,"precipitation":0.00,"weather_code":3,"cloud_cover":98,"wind_speed_10m":21.6,"wind_direction_10m":314,"wind_gusts_10m":41.4,"pressure_msl":1020.7,"relative_humidity_2m":73},"minutely_15_units":{"time":"unixtime","precipitation":"mm"},"minutely_15":{"time":[1794040200,1794041100,1794042000,1794042900,1794043800,1794044700,1794045600,1794046500,1794047400],"precipitation":[0.00,0.00,0.00,0.00,0.00,0.00,0.00,0.00,0.00]},"hourly_units":{"time":"unixtime","temperature_2m":"°C","apparent_temperature":"°C","relative_humidity_2m":"%","precipitation_probability":"%","precipitation":"mm","weather_code":"wmo code","cloud_cover":"%","wind_speed_10m":"km/h","wind_direction_10m":"°","wind_gusts_10m":"km/h","uv_index":"","is_day":""},"hourly":{"time":[1794038400,1794042000,1794045600,1794049200,1794052800,1794056400,1794060000,1794063600,1794067200,1794070800,1794074400,1794078000,1794081600,1794085200,1794088800,1794092400,1794096000,1794099600,1794103200,1794106800,1794110400,1794114000,1794117600,1794121200,1794124800],"temperature_2m":[7.3,7.1,7.3,7.3,7.3,7.3,7.3,7.5,7.7,7.8,7.7,7.5,7.5,7.6,7.7,7.7,7.7,7.9,8.0,8.0,8.0,8.1,8.1,8.0,8.2],"apparent_temperature":[2.2,2.5,2.8,3.0,2.9,2.8,3.0,3.2,3.2,3.3,3.1,3.1,3.4,3.4,3.0,3.4,3.4,3.6,3.8,3.6,3.7,3.9,4.3,4.5,4.6],"relative_humidity_2m":[73,72,72,75,78,80,80,80,79,79,80,80,80,81,82,82,82,80,80,81,82,82,82,82,81],"precipitation_probability":[0,0,0,0,0,0,0,0,0,0,0,0,0,0,0,0,0,0,0,0,0,0,0,0,0],"precipitation":[0.00,0.00,0.00,0.00,0.00,0.00,0.00,0.00,0.00,0.00,0.00,0.00,0.00,0.00,0.00,0.00,0.00,0.00,0.00,0.00,0.00,0.00,0.00,0.00,0.00],"weather_code":[3,3,3,3,3,3,3,3,3,3,3,3,3,3,3,3,3,3,3,3,3,3,3,3,2],"cloud_cover":[100,96,96,94,99,100,100,100,100,100,100,100,86,92,100,99,98,98,93,97,92,86,89,82,72],"wind_speed_10m":[23.4,19.4,19.1,18.7,19.4,21.2,20.2,20.2,21.6,21.6,22.3,20.5,18.7,19.4,23.8,20.5,21.2,20.5,19.8,21.6,21.6,20.2,17.6,16.2,16.2],"wind_direction_10m":[313,314,312,303,294,297,297,298,304,311,315,312,305,300,306,304,304,302,300,302,303,305,304,304,298],"wind_gusts_10m":[41.0,41.0,35.6,34.6,35.3,38.5,37.4,35.6,37.4,37.4,38.9,38.5,35.3,33.5,41.0,40.7,37.1,36.7,36.0,37.4,37.8,37.8,34.9,31.0,28.4],"uv_index":[0.45,0.75,0.95,1.05,0.85,0.50,0.15,0.00,0.00,0.00,0.00,0.00,0.00,0.00,0.00,0.00,0.00,0.00,0.00,0.00,0.00,0.00,0.00,0.10,0.45],"is_day":[1,1,1,1,1,1,1,0,0,0,0,0,0,0,0,0,0,0,0,0,0,0,1,1,1]},"daily_units":{"time":"unixtime","weather_code":"wmo code","temperature_2m_max":"°C","temperature_2m_min":"°C","apparent_temperature_max":"°C","apparent_temperature_min":"°C","sunrise":"unixtime","sunset":"unixtime","sunshine_duration":"s","uv_index_max":"","precipitation_sum":"mm","snowfall_sum":"cm","precipitation_hours":"h","precipitation_probability_max":"%","wind_speed_10m_max":"km/h","wind_gusts_10m_max":"km/h","wind_direction_10m_dominant":"°"},"daily":{"time":[1794002400,1794088800,1794175200,1794261600,1794348000,1794434400,1794520800],"weather_code":[3,3,3,51,85,71,51],"temperature_2m_max":[7.8,8.8,7.4,6.6,5.0,5.9,5.2],"temperature_2m_min":[6.4,5.6,5.4,2.4,1.3,1.4,2.7],"apparent_temperature_max":[3.4,5.7,3.7,3.4,1.0,1.6,0.4],"apparent_temperature_min":[1.9,2.7,1.7,-0.8,-2.7,-3.3,-1.7],"sunrise":[1794030929,1794117481,1794204032,1794290582,1794377132,1794463682,1794550230],"sunset":[1794060782,1794147039,1794233298,1794319559,1794405822,1794492088,1794578356],"sunshine_duration":[4163.08,21589.38,0.00,0.00,1714.91,10200.67,26374.13],"uv_index_max":[1.05,1.00,0.95,0.35,0.65,0.65,0.85],"precipitation_sum":[0.00,0.00,0.00,0.10,1.20,4.50,0.30],"snowfall_sum":[0.00,0.00,0.00,0.00,0.21,0.63,0.00],"precipitation_hours":[0.0,0.0,0.0,1.0,12.0,12.0,3.0],"precipitation_probability_max":[0,0,0,6,24,37,43],"wind_speed_10m_max":[23.4,23.8,20.9,16.0,16.5,19.2,21.2],"wind_gusts_10m_max":[41.0,41.0,37.4,33.5,33.5,45.7,52.9],"wind_direction_10m_dominant":[302,286,232,209,191,178,218]}})OM"
