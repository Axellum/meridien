// FICHIER GÉNÉRÉ par test/host/controle_python_modeles.py : ne pas modifier à la main.
// Réponse réelle d'Open-Meteo (noaa, Lyon, requête complète du firmware + models=), voir donnees/LISEZMOI.md.
R"OM({"latitude":45.746826,"longitude":4.8046875,"generationtime_ms":0.5714893341064453,"utc_offset_seconds":3600,"timezone":"Europe/Paris","timezone_abbreviation":"GMT+1","elevation":176.0,"current_units":{"time":"unixtime","interval":"seconds","temperature_2m":"°C","apparent_temperature":"°C","is_day":"","precipitation":"mm","weather_code":"wmo code","cloud_cover":"%","wind_speed_10m":"km/h","wind_direction_10m":"°","wind_gusts_10m":"km/h","pressure_msl":"hPa","relative_humidity_2m":"%"},"current":{"time":1794040200,"interval":900,"temperature_2m":9.0,"apparent_temperature":7.5,"is_day":1,"precipitation":0.00,"weather_code":1,"cloud_cover":22,"wind_speed_10m":2.3,"wind_direction_10m":321,"wind_gusts_10m":3.6,"pressure_msl":1025.0,"relative_humidity_2m":75},"minutely_15_units":{"time":"unixtime","precipitation":"mm"},"minutely_15":{"time":[1794040200,1794041100,1794042000,1794042900,1794043800,1794044700,1794045600,1794046500,1794047400],"precipitation":[0.00,0.00,0.00,0.00,0.00,0.00,0.00,0.00,0.00]},"hourly_units":{"time":"unixtime","temperature_2m":"°C","apparent_temperature":"°C","relative_humidity_2m":"%","precipitation_probability":"%","precipitation":"mm","weather_code":"wmo code","cloud_cover":"%","wind_speed_10m":"km/h","wind_direction_10m":"°","wind_gusts_10m":"km/h","uv_index":"","is_day":""},"hourly":{"time":[1794038400,1794042000,1794045600,1794049200,1794052800,1794056400,1794060000,1794063600,1794067200,1794070800,1794074400,1794078000,1794081600,1794085200,1794088800,1794092400,1794096000,1794099600,1794103200,1794106800,1794110400,1794114000,1794117600,1794121200,1794124800],"temperature_2m":[8.3,9.8,11.0,11.9,12.7,13.2,13.4,13.1,12.0,11.1,10.5,10.0,9.5,9.0,8.7,8.3,7.8,7.6,7.4,7.2,7.3,7.7,7.7,8.2,9.0],"apparent_temperature":[6.6,8.2,9.3,10.2,11.0,11.5,11.7,11.5,10.4,9.5,8.8,8.2,7.6,7.1,6.7,6.4,5.9,5.6,5.5,5.4,5.4,5.8,6.3,6.5,6.9],"relative_humidity_2m":[78,71,66,62,58,55,53,54,58,62,65,67,70,73,75,78,81,82,83,84,83,81,79,76,71],"precipitation_probability":[0,0,0,0,0,0,0,0,0,0,0,0,0,0,0,0,0,0,0,0,0,0,0,0,0],"precipitation":[0.00,0.00,0.00,0.00,0.00,0.00,0.00,0.00,0.00,0.00,0.00,0.00,0.00,0.00,0.00,0.00,0.00,0.00,0.00,0.00,0.00,0.00,0.00,0.00,0.00],"weather_code":[1,0,0,0,0,0,0,0,0,0,0,0,0,1,3,0,0,3,3,3,3,3,3,3,3],"cloud_cover":[48,0,0,0,0,5,5,0,6,5,14,7,13,27,89,6,6,100,100,97,96,100,100,100,92],"wind_speed_10m":[3.1,2.2,3.2,3.3,2.8,2.4,1.9,1.1,1.1,1.3,2.3,2.7,3.7,4.3,4.7,4.4,4.9,4.7,4.3,3.8,4.1,4.0,0.5,2.6,4.9],"wind_direction_10m":[291,351,27,41,50,63,68,72,108,236,231,203,209,204,184,171,163,171,156,163,165,180,225,164,163],"wind_gusts_10m":[4.7,2.5,2.5,2.5,2.5,2.2,1.8,1.1,1.8,1.4,2.2,2.9,4.0,4.3,4.7,4.0,5.8,7.6,6.1,5.4,6.1,8.6,1.1,3.6,8.6],"uv_index":[0.50,1.30,2.10,2.65,2.85,2.60,1.95,1.15,0.35,0.00,0.00,0.00,0.00,0.00,0.00,0.00,0.00,0.00,0.00,0.00,0.00,0.00,0.00,0.00,0.45],"is_day":[1,1,1,1,1,1,1,1,1,0,0,0,0,0,0,0,0,0,0,0,0,0,0,1,1]},"daily_units":{"time":"unixtime","weather_code":"wmo code","temperature_2m_max":"°C","temperature_2m_min":"°C","apparent_temperature_max":"°C","apparent_temperature_min":"°C","sunrise":"unixtime","sunset":"unixtime","sunshine_duration":"s","uv_index_max":"","precipitation_sum":"mm","snowfall_sum":"cm","precipitation_hours":"h","precipitation_probability_max":"%","wind_speed_10m_max":"km/h","wind_gusts_10m_max":"km/h","wind_direction_10m_dominant":"°"},"daily":{"time":[1794006000,1794092400,1794178800,1794265200,1794351600,1794438000,1794524400],"weather_code":[3,3,61,53,51,61,61],"temperature_2m_max":[13.4,15.7,16.8,18.2,18.4,15.0,12.6],"temperature_2m_min":[6.9,7.2,11.3,12.0,11.0,12.6,7.1],"apparent_temperature_max":[11.7,12.7,14.0,18.4,16.7,14.6,12.7],"apparent_temperature_min":[4.8,5.4,9.6,11.3,10.4,12.5,4.5],"sunrise":[1794032947,1794119432,1794205918,1794292404,1794378889,1794465373,1794551858],"sunset":[1794068360,1794154682,1794241006,1794327332,1794413660,1794499990,1794586322],"sunshine_duration":[32720.45,32402.61,26168.22,30050.42,27769.37,0.00,0.00],"uv_index_max":[2.85,2.40,2.20,2.30,2.35,0.35,0.35],"precipitation_sum":[0.00,0.00,4.80,4.50,1.30,23.40,15.90],"snowfall_sum":[0.00,0.00,0.00,0.00,0.00,0.00,0.00],"precipitation_hours":[0.0,0.0,4.0,14.0,6.0,19.0,14.0],"precipitation_probability_max":[0,0,47,69,19,61,59],"wind_speed_10m_max":[5.4,16.8,21.8,13.0,20.0,8.2,12.9],"wind_gusts_10m_max":[5.4,24.1,33.1,27.0,36.4,17.6,20.9],"wind_direction_10m_dominant":[271,172,167,157,171,143,349]}})OM"
