// FICHIER GÉNÉRÉ par test/host/controle_python_modeles.py : ne pas modifier à la main.
// Réponse réelle d'Open-Meteo (knmi, Bruxelles, requête complète du firmware + models=), voir donnees/LISEZMOI.md.
R"OM({"latitude":50.854,"longitude":4.35,"generationtime_ms":1.2274980545043945,"utc_offset_seconds":3600,"timezone":"Europe/Brussels","timezone_abbreviation":"GMT+1","elevation":26.0,"current_units":{"time":"unixtime","interval":"seconds","temperature_2m":"°C","apparent_temperature":"°C","is_day":"","precipitation":"mm","weather_code":"wmo code","cloud_cover":"%","wind_speed_10m":"km/h","wind_direction_10m":"°","wind_gusts_10m":"km/h","pressure_msl":"hPa","relative_humidity_2m":"%"},"current":{"time":1794040200,"interval":900,"temperature_2m":7.4,"apparent_temperature":5.3,"is_day":1,"precipitation":0.20,"weather_code":53,"cloud_cover":100,"wind_speed_10m":7.2,"wind_direction_10m":211,"wind_gusts_10m":13.7,"pressure_msl":1023.5,"relative_humidity_2m":91},"minutely_15_units":{"time":"unixtime","precipitation":"mm"},"minutely_15":{"time":[1794040200,1794041100,1794042000,1794042900,1794043800,1794044700,1794045600,1794046500,1794047400],"precipitation":[0.20,0.20,0.20,0.20,0.20,0.20,0.20,0.20,0.20]},"hourly_units":{"time":"unixtime","temperature_2m":"°C","apparent_temperature":"°C","relative_humidity_2m":"%","precipitation_probability":"%","precipitation":"mm","weather_code":"wmo code","cloud_cover":"%","wind_speed_10m":"km/h","wind_direction_10m":"°","wind_gusts_10m":"km/h","uv_index":"","is_day":""},"hourly":{"time":[1794038400,1794042000,1794045600,1794049200,1794052800,1794056400,1794060000,1794063600,1794067200,1794070800,1794074400,1794078000,1794081600,1794085200,1794088800,1794092400,1794096000,1794099600,1794103200,1794106800,1794110400,1794114000,1794117600,1794121200,1794124800],"temperature_2m":[7.4,7.4,7.5,7.6,7.6,8.3,8.6,8.6,8.6,8.6,8.5,8.4,8.4,8.4,8.2,7.9,7.2,6.6,7.1,7.6,7.7,7.6,7.6,7.3,7.5],"apparent_temperature":[5.3,5.4,5.4,5.5,5.6,6.5,6.7,6.6,6.7,6.5,6.5,6.1,6.0,5.8,5.7,5.6,4.6,4.0,4.5,5.2,4.8,4.8,4.7,4.0,4.3],"relative_humidity_2m":[91,91,90,90,90,90,90,92,93,94,94,95,94,92,89,89,89,90,88,86,84,85,85,86,83],"precipitation_probability":[43,35,34,35,37,38,39,41,46,52,55,53,47,43,42,43,41,35,27,20,17,15,14,13,13],"precipitation":[0.70,0.70,0.70,0.60,0.60,0.20,0.00,0.00,0.00,0.00,0.00,0.60,0.80,0.70,0.10,0.00,0.00,0.00,0.00,0.00,0.00,0.10,0.20,0.50,0.30],"weather_code":[53,53,53,53,53,51,3,3,3,3,3,53,53,53,51,2,0,0,3,3,3,51,51,53,51],"cloud_cover":[100,100,100,100,100,100,100,100,100,100,100,100,100,100,100,52,0,1,100,100,100,100,100,100,100],"wind_speed_10m":[7.2,6.8,7.2,7.6,7.2,6.8,7.9,9.0,8.6,10.1,9.0,11.2,11.9,12.6,11.2,9.0,9.7,9.0,9.7,8.6,11.2,10.8,12.2,14.8,13.0],"wind_direction_10m":[212,210,200,208,207,212,215,215,211,209,203,219,221,219,220,196,196,177,185,192,190,198,197,193,191],"wind_gusts_10m":[13.3,14.0,14.0,14.4,14.8,15.5,15.5,17.3,17.3,19.1,18.7,20.9,22.3,24.1,23.4,20.5,16.6,16.2,18.0,18.4,20.5,22.7,22.7,28.8,27.4],"uv_index":[0.25,0.65,0.80,0.65,0.80,0.50,0.20,0.05,0.00,0.00,0.00,0.00,0.00,0.00,0.00,0.00,0.00,0.00,0.00,0.00,0.00,0.00,0.00,0.00,0.20],"is_day":[1,1,1,1,1,1,1,1,1,0,0,0,0,0,0,0,0,0,0,0,0,0,0,1,1]},"daily_units":{"time":"unixtime","weather_code":"wmo code","temperature_2m_max":"°C","temperature_2m_min":"°C","apparent_temperature_max":"°C","apparent_temperature_min":"°C","sunrise":"unixtime","sunset":"unixtime","sunshine_duration":"s","uv_index_max":"","precipitation_sum":"mm","snowfall_sum":"cm","precipitation_hours":"h","precipitation_probability_max":"%","wind_speed_10m_max":"km/h","wind_gusts_10m_max":"km/h","wind_direction_10m_dominant":"°"},"daily":{"time":[1794006000,1794092400,1794178800,1794265200,1794351600,1794438000,1794524400],"weather_code":[53,53,1,53,53,53,3],"temperature_2m_max":[8.6,10.3,10.9,9.8,14.1,11.5,9.5],"temperature_2m_min":[6.8,6.2,3.7,2.3,8.7,7.5,3.6],"apparent_temperature_max":[6.7,7.5,8.0,7.7,12.7,11.0,5.6],"apparent_temperature_min":[4.5,4.0,1.6,-1.1,8.1,4.5,1.1],"sunrise":[1794033877,1794120381,1794206885,1794293388,1794379891,1794466393,1794552895],"sunset":[1794067642,1794153947,1794240253,1794326561,1794412871,1794499183,1794585498],"sunshine_duration":[0.00,7193.37,32298.52,0.00,4316.09,0.00,31871.98],"uv_index_max":[0.80,1.75,2.00,1.75,1.15,0.85,1.70],"precipitation_sum":[6.50,1.30,0.00,2.30,2.70,2.70,0.00],"snowfall_sum":[0.00,0.00,0.00,0.00,0.00,0.00,0.00],"precipitation_hours":[13.0,5.0,0.0,6.0,9.0,12.0,0.0],"precipitation_probability_max":[63,43,1,10,41,59,59],"wind_speed_10m_max":[12.6,16.6,10.1,12.6,16.3,14.9,14.8],"wind_gusts_10m_max":[24.1,32.4,19.4,27.7,36.7,34.2,37.8],"wind_direction_10m_dominant":[213,194,104,92,200,7,17]}})OM"
