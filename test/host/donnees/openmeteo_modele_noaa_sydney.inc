// FICHIER GÉNÉRÉ par test/host/controle_python_modeles.py : ne pas modifier à la main.
// Réponse réelle d'Open-Meteo (noaa, Sydney, requête complète du firmware + models=), voir donnees/LISEZMOI.md.
R"OM({"latitude":-33.914734,"longitude":151.17188,"generationtime_ms":1.0262727737426758,"utc_offset_seconds":39600,"timezone":"Australia/Sydney","timezone_abbreviation":"GMT+11","elevation":51.0,"current_units":{"time":"unixtime","interval":"seconds","temperature_2m":"°C","apparent_temperature":"°C","is_day":"","precipitation":"mm","weather_code":"wmo code","cloud_cover":"%","wind_speed_10m":"km/h","wind_direction_10m":"°","wind_gusts_10m":"km/h","pressure_msl":"hPa","relative_humidity_2m":"%"},"current":{"time":1794040200,"interval":900,"temperature_2m":15.2,"apparent_temperature":9.9,"is_day":0,"precipitation":0.10,"weather_code":51,"cloud_cover":99,"wind_speed_10m":40.3,"wind_direction_10m":181,"wind_gusts_10m":46.1,"pressure_msl":1014.5,"relative_humidity_2m":81},"minutely_15_units":{"time":"unixtime","precipitation":"mm"},"minutely_15":{"time":[1794040200,1794041100,1794042000,1794042900,1794043800,1794044700,1794045600,1794046500,1794047400],"precipitation":[0.10,0.10,0.10,0.10,0.10,0.10,0.10,0.00,0.00]},"hourly_units":{"time":"unixtime","temperature_2m":"°C","apparent_temperature":"°C","relative_humidity_2m":"%","precipitation_probability":"%","precipitation":"mm","weather_code":"wmo code","cloud_cover":"%","wind_speed_10m":"km/h","wind_direction_10m":"°","wind_gusts_10m":"km/h","uv_index":"","is_day":""},"hourly":{"time":[1794038400,1794042000,1794045600,1794049200,1794052800,1794056400,1794060000,1794063600,1794067200,1794070800,1794074400,1794078000,1794081600,1794085200,1794088800,1794092400,1794096000,1794099600,1794103200,1794106800,1794110400,1794114000,1794117600,1794121200,1794124800],"temperature_2m":[15.6,14.9,14.8,14.8,13.9,13.4,13.3,12.5,12.4,11.7,11.2,10.5,11.1,12.5,13.7,14.7,15.0,13.7,14.0,14.8,15.9,17.7,17.3,16.5,15.4],"apparent_temperature":[10.5,9.6,9.5,9.6,8.2,8.0,8.1,7.2,6.7,6.2,5.2,4.9,5.7,7.0,7.6,9.4,9.9,8.0,8.3,8.8,9.7,11.5,10.6,9.8,9.0],"relative_humidity_2m":[82,79,70,63,66,64,58,55,52,53,48,50,50,52,51,56,63,67,65,59,48,41,42,43,49],"precipitation_probability":[96,100,100,100,97,71,37,13,10,17,26,33,41,52,68,85,97,100,97,87,66,38,19,15,19],"precipitation":[0.60,0.40,0.20,0.00,0.30,0.10,0.00,0.00,0.00,0.00,0.00,0.00,0.00,0.00,0.00,0.00,0.60,0.80,0.50,0.50,0.20,0.00,0.00,0.00,0.00],"weather_code":[53,51,51,2,51,51,3,3,3,3,2,0,1,0,0,1,53,53,53,53,51,2,0,0,0],"cloud_cover":[100,99,100,57,100,100,95,100,100,84,67,9,23,5,7,27,67,100,100,100,100,51,7,0,6],"wind_speed_10m":[40.9,39.0,35.0,32.1,35.1,30.9,27.2,26.1,27.4,25.5,26.7,23.9,23.2,26.6,32.0,34.7,34.7,34.8,34.8,35.5,33.7,37.4,37.5,35.8,35.3],"wind_direction_10m":[187,175,185,192,201,206,217,210,213,220,226,226,227,213,197,197,197,191,194,193,191,180,183,186,183],"wind_gusts_10m":[44.6,47.2,46.8,41.8,42.1,41.4,37.1,34.6,35.3,36.7,37.8,39.2,40.7,45.4,48.2,46.1,45.7,45.7,46.1,46.8,46.8,44.3,46.1,46.4,47.2],"uv_index":[0.40,0.00,0.00,0.00,0.00,0.00,0.00,0.00,0.00,0.00,0.00,0.00,0.40,1.65,3.40,5.30,5.45,2.30,2.90,4.15,3.65,5.60,4.05,2.20,0.70],"is_day":[1,0,0,0,0,0,0,0,0,0,0,1,1,1,1,1,1,1,1,1,1,1,1,1,1]},"daily_units":{"time":"unixtime","weather_code":"wmo code","temperature_2m_max":"°C","temperature_2m_min":"°C","apparent_temperature_max":"°C","apparent_temperature_min":"°C","sunrise":"unixtime","sunset":"unixtime","sunshine_duration":"s","uv_index_max":"","precipitation_sum":"mm","snowfall_sum":"cm","precipitation_hours":"h","precipitation_probability_max":"%","wind_speed_10m_max":"km/h","wind_gusts_10m_max":"km/h","wind_direction_10m_dominant":"°"},"daily":{"time":[1793970000,1794056400,1794142800,1794229200,1794315600,1794402000,1794488400],"weather_code":[53,53,51,3,51,51,51],"temperature_2m_max":[31.4,17.7,18.7,24.1,37.3,20.8,21.9],"temperature_2m_min":[13.4,10.5,10.3,10.8,15.4,15.7,17.1],"apparent_temperature_max":[29.3,11.5,15.5,24.2,34.5,18.0,20.9],"apparent_temperature_min":[8.2,4.9,6.1,8.7,14.4,11.3,15.4],"sunrise":[1793990991,1794077341,1794163691,1794250044,1794336397,1794422753,1794509110],"sunset":[1794040122,1794126579,1794213037,1794299494,1794385952,1794472409,1794558867],"sunshine_duration":[40354.19,42527.84,47766.80,47786.67,43845.46,41784.95,43800.96],"uv_index_max":[8.05,5.60,8.70,8.75,8.40,7.55,7.35],"precipitation_sum":[1.90,2.70,0.10,0.00,0.50,1.20,0.90],"snowfall_sum":[0.00,0.00,0.00,0.00,0.00,0.00,0.00],"precipitation_hours":[6.0,6.0,1.0,0.0,3.0,12.0,9.0],"precipitation_probability_max":[100,100,49,3,33,61,24],"wind_speed_10m_max":[48.2,37.5,31.3,24.5,48.2,34.0,20.6],"wind_gusts_10m_max":[47.2,48.2,40.0,34.9,67.7,45.0,29.5],"wind_direction_10m_dominant":[208,197,190,36,223,187,136]}})OM"
