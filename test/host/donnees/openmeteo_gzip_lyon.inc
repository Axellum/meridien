// FICHIER GÉNÉRÉ par test/host/controle_python_gzip.py : ne pas modifier à la main.
// Réponse RÉELLE d'Open-Meteo pour lyon, requête du firmware avec Accept-Encoding: gzip : octets du fil, puis texte
// décompressé par Python (gzip.decompress), voir donnees/LISEZMOI.md et capturer_gzip_meteo.py.
inline constexpr std::uint8_t OM_GZ_LYON[] = {
    0x1f, 0x8b, 0x08, 0x00, 0x00, 0x00, 0x00, 0x00, 0x00, 0x03, 0xc4, 0x55, 0xc9, 0x8e, 0xdb, 0x46,
    0x10, 0xfd, 0x95, 0x80, 0x80, 0x4f, 0x21, 0xe8, 0xde, 0x17, 0x5f, 0x83, 0x20, 0xa7, 0x00, 0x3e,
    0xe4, 0x46, 0x08, 0x04, 0x67, 0xd4, 0x9e, 0x21, 0x22, 0x92, 0x02, 0x17, 0x79, 0x26, 0x46, 0xfe,
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    0x03, 0x00, 0x26, 0xa3, 0x48, 0x1d, 0x5b, 0x11, 0x00, 0x00,
};
inline constexpr std::size_t OM_GZ_LYON_TAILLE = 1498;
inline constexpr std::uint8_t OM_GZ_LYON_JSON[] = {
    0x7b, 0x22, 0x6c, 0x61, 0x74, 0x69, 0x74, 0x75, 0x64, 0x65, 0x22, 0x3a, 0x34, 0x35, 0x2e, 0x37,
    0x35, 0x35, 0x33, 0x36, 0x33, 0x2c, 0x22, 0x6c, 0x6f, 0x6e, 0x67, 0x69, 0x74, 0x75, 0x64, 0x65,
    0x22, 0x3a, 0x34, 0x2e, 0x38, 0x35, 0x32, 0x35, 0x34, 0x36, 0x2c, 0x22, 0x67, 0x65, 0x6e, 0x65,
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    0x2c, 0x31, 0x37, 0x34, 0x2c, 0x33, 0x34, 0x31, 0x5d, 0x7d, 0x7d,
};
inline constexpr std::size_t OM_GZ_LYON_JSON_TAILLE = 4443;
inline constexpr std::uint32_t OM_GZ_LYON_CRC = 0x1d48a326;
inline constexpr std::size_t OM_GZ_LYON_DEBUT = 10;
