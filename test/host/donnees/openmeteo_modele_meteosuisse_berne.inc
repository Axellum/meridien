// FICHIER GÉNÉRÉ par test/host/controle_python_modeles.py : ne pas modifier à la main.
// Réponse réelle d'Open-Meteo (meteosuisse, Berne, requête complète du firmware + models=), voir donnees/LISEZMOI.md.
R"OM({"latitude":46.951687,"longitude":7.4505615,"generationtime_ms":1.324295997619629,"utc_offset_seconds":3600,"timezone":"Europe/Zurich","timezone_abbreviation":"GMT+1","elevation":525.0,"current_units":{"time":"unixtime","interval":"seconds","temperature_2m":"°C","apparent_temperature":"°C","is_day":"","precipitation":"mm","weather_code":"wmo code","cloud_cover":"%","wind_speed_10m":"km/h","wind_direction_10m":"°","wind_gusts_10m":"km/h","pressure_msl":"hPa","relative_humidity_2m":"%"},"current":{"time":1794040200,"interval":900,"temperature_2m":7.9,"apparent_temperature":7.3,"is_day":1,"precipitation":0.00,"weather_code":3,"cloud_cover":100,"wind_speed_10m":0.4,"wind_direction_10m":360,"wind_gusts_10m":4.0,"pressure_msl":1024.2,"relative_humidity_2m":98},"minutely_15_units":{"time":"unixtime","precipitation":"mm"},"minutely_15":{"time":[1794040200,1794041100,1794042000,1794042900,1794043800,1794044700,1794045600,1794046500,1794047400],"precipitation":[0.00,0.00,0.00,0.00,0.00,0.00,0.00,0.00,0.00]},"hourly_units":{"time":"unixtime","temperature_2m":"°C","apparent_temperature":"°C","relative_humidity_2m":"%","precipitation_probability":"%","precipitation":"mm","weather_code":"wmo code","cloud_cover":"%","wind_speed_10m":"km/h","wind_direction_10m":"°","wind_gusts_10m":"km/h","uv_index":"undefined","is_day":""},"hourly":{"time":[1794038400,1794042000,1794045600,1794049200,1794052800,1794056400,1794060000,1794063600,1794067200,1794070800,1794074400,1794078000,1794081600,1794085200,1794088800,1794092400,1794096000,1794099600,1794103200,1794106800,1794110400,1794114000,1794117600,1794121200,1794124800],"temperature_2m":[7.8,8.1,8.8,9.6,10.5,10.7,10.6,10.4,10.1,9.2,8.5,7.7,7.4,7.4,7.3,7.3,7.0,6.7,6.6,6.3,6.1,5.9,5.6,5.6,5.8],"apparent_temperature":[7.0,7.4,7.8,8.7,9.2,9.3,9.0,9.2,8.7,7.8,7.4,6.5,6.3,6.2,6.3,6.1,5.8,5.5,5.5,4.9,5.0,4.6,4.2,4.1,4.3],"relative_humidity_2m":[98,97,92,87,79,77,76,80,81,89,92,95,95,96,96,96,97,98,99,97,98,100,100,100,97],"precipitation_probability":[9,9,18,0,0,0,0,0,0,0,0,0,0,0,0,0,0,0,0,0,0,0,0,0,0],"precipitation":[0.00,0.00,0.00,0.00,0.00,0.00,0.00,0.00,0.00,0.00,0.00,0.00,0.00,0.00,0.00,0.00,0.00,0.00,0.00,0.00,0.00,0.00,0.00,0.00,0.00],"weather_code":[3,3,3,3,3,3,3,3,3,2,2,2,3,3,3,3,3,3,3,2,3,3,3,3,3],"cloud_cover":[100,100,90,87,94,94,97,100,91,75,50,73,89,88,90,91,86,91,81,79,92,97,100,97,85],"wind_speed_10m":[1.3,1.1,2.3,2.4,4.0,4.5,5.4,3.7,4.4,4.7,3.1,2.9,2.3,2.2,1.6,2.6,2.9,2.6,1.3,2.3,0.8,1.8,2.5,2.4,2.6],"wind_direction_10m":[56,270,288,297,350,14,8,11,35,356,339,330,288,279,297,56,187,236,124,129,117,127,135,117,146],"wind_gusts_10m":[5.0,3.6,5.8,6.8,11.2,11.2,18.4,13.0,11.2,12.6,9.4,7.2,6.1,4.7,5.0,5.4,8.6,6.1,7.2,5.0,4.7,4.0,6.1,6.8,6.8],"uv_index":[null,null,null,null,null,null,null,null,null,null,null,null,null,null,null,null,null,null,null,null,null,null,null,null,null],"is_day":[1,1,1,1,1,1,1,1,1,0,0,0,0,0,0,0,0,0,0,0,0,0,0,1,1]},"daily_units":{"time":"unixtime","weather_code":"wmo code","temperature_2m_max":"°C","temperature_2m_min":"°C","apparent_temperature_max":"°C","apparent_temperature_min":"°C","sunrise":"unixtime","sunset":"unixtime","sunshine_duration":"s","uv_index_max":"undefined","precipitation_sum":"mm","snowfall_sum":"cm","precipitation_hours":"h","precipitation_probability_max":"%","wind_speed_10m_max":"km/h","wind_gusts_10m_max":"km/h","wind_direction_10m_dominant":"°"},"daily":{"time":[1794006000,1794092400,1794178800,1794265200,1794351600,1794438000,1794524400],"weather_code":[51,3,53,63,51,null,null],"temperature_2m_max":[10.7,10.9,10.9,15.1,14.3,null,null],"temperature_2m_min":[7.3,5.6,7.1,8.9,7.0,null,null],"apparent_temperature_max":[9.3,9.3,9.8,15.8,13.8,null,null],"apparent_temperature_min":[6.2,4.1,5.9,8.3,6.1,null,null],"sunrise":[1794032489,1794118979,1794205468,1794291958,1794378447,1794464935,1794551423],"sunset":[1794067546,1794153865,1794240185,1794326507,1794412831,1794499157,1794585485],"sunshine_duration":[840.00,21810.00,420.00,6660.00,8760.00,null,null],"uv_index_max":[null,null,null,null,null,null,null],"precipitation_sum":[0.60,0.00,5.00,11.80,0.20,null,null],"snowfall_sum":[0.00,0.00,0.00,0.00,0.00,null,null],"precipitation_hours":[4.0,0.0,12.0,9.0,2.0,0.0,0.0],"precipitation_probability_max":[73,19,67,86,29,null,null],"wind_speed_10m_max":[5.4,3.4,2.3,3.1,3.2,null,null],"wind_gusts_10m_max":[18.4,9.0,7.2,8.6,7.2,null,null],"wind_direction_10m_dominant":[6,148,162,152,158,null,null]}})OM"
