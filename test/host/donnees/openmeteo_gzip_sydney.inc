// FICHIER GÉNÉRÉ par test/host/controle_python_gzip.py : ne pas modifier à la main.
// Réponse RÉELLE d'Open-Meteo pour sydney, requête du firmware avec Accept-Encoding: gzip : octets du fil, puis texte
// décompressé par Python (gzip.decompress), voir donnees/LISEZMOI.md et capturer_gzip_meteo.py.
inline constexpr std::uint8_t OM_GZ_SYDNEY[] = {
    0x1f, 0x8b, 0x08, 0x00, 0x00, 0x00, 0x00, 0x00, 0x00, 0x03, 0xc4, 0x55, 0xcb, 0xae, 0xdb, 0x36,
    0x10, 0xfd, 0x95, 0x42, 0x40, 0x56, 0x65, 0x15, 0xbe, 0x49, 0x65, 0x57, 0x74, 0xd1, 0x55, 0x81,
    0x02, 0xed, 0x4e, 0x30, 0x04, 0x5d, 0x9b, 0xb9, 0x16, 0x6a, 0xc9, 0x86, 0x2c, 0x39, 0x71, 0x83,
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    0x03, 0x00, 0x3b, 0xc2, 0x41, 0x5a, 0xdf, 0x11, 0x00, 0x00,
};
inline constexpr std::size_t OM_GZ_SYDNEY_TAILLE = 1626;
inline constexpr std::uint8_t OM_GZ_SYDNEY_JSON[] = {
    0x7b, 0x22, 0x6c, 0x61, 0x74, 0x69, 0x74, 0x75, 0x64, 0x65, 0x22, 0x3a, 0x2d, 0x33, 0x33, 0x2e,
    0x38, 0x34, 0x38, 0x38, 0x35, 0x38, 0x2c, 0x22, 0x6c, 0x6f, 0x6e, 0x67, 0x69, 0x74, 0x75, 0x64,
    0x65, 0x22, 0x3a, 0x31, 0x35, 0x31, 0x2e, 0x31, 0x39, 0x35, 0x35, 0x31, 0x2c, 0x22, 0x67, 0x65,
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    0x39, 0x2c, 0x31, 0x32, 0x35, 0x2c, 0x31, 0x32, 0x38, 0x2c, 0x33, 0x35, 0x5d, 0x7d, 0x7d,
};
inline constexpr std::size_t OM_GZ_SYDNEY_JSON_TAILLE = 4575;
inline constexpr std::uint32_t OM_GZ_SYDNEY_CRC = 0x5a41c23b;
inline constexpr std::size_t OM_GZ_SYDNEY_DEBUT = 10;
