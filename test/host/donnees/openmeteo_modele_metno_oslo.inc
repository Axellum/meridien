// FICHIER GÉNÉRÉ par test/host/controle_python_modeles.py : ne pas modifier à la main.
// Réponse réelle d'Open-Meteo (metno, Oslo, requête complète du firmware + models=), voir donnees/LISEZMOI.md.
R"OM({"latitude":59.915257,"longitude":10.74292,"generationtime_ms":0.5539655685424805,"utc_offset_seconds":3600,"timezone":"Europe/Oslo","timezone_abbreviation":"GMT+1","elevation":21.0,"current_units":{"time":"unixtime","interval":"seconds","temperature_2m":"°C","apparent_temperature":"°C","is_day":"","precipitation":"mm","weather_code":"wmo code","cloud_cover":"%","wind_speed_10m":"km/h","wind_direction_10m":"°","wind_gusts_10m":"km/h","pressure_msl":"hPa","relative_humidity_2m":"%"},"current":{"time":1794040200,"interval":900,"temperature_2m":0.7,"apparent_temperature":-1.9,"is_day":1,"precipitation":0.00,"weather_code":0,"cloud_cover":11,"wind_speed_10m":1.4,"wind_direction_10m":302,"wind_gusts_10m":4.0,"pressure_msl":1029.4,"relative_humidity_2m":82},"minutely_15_units":{"time":"unixtime","precipitation":"mm"},"minutely_15":{"time":[1794040200,1794041100,1794042000,1794042900,1794043800,1794044700,1794045600,1794046500,1794047400],"precipitation":[0.00,0.00,0.00,0.00,0.00,0.00,0.00,0.00,0.00]},"hourly_units":{"time":"unixtime","temperature_2m":"°C","apparent_temperature":"°C","relative_humidity_2m":"%","precipitation_probability":"%","precipitation":"mm","weather_code":"wmo code","cloud_cover":"%","wind_speed_10m":"km/h","wind_direction_10m":"°","wind_gusts_10m":"km/h","uv_index":"","is_day":""},"hourly":{"time":[1794038400,1794042000,1794045600,1794049200,1794052800,1794056400,1794060000,1794063600,1794067200,1794070800,1794074400,1794078000,1794081600,1794085200,1794088800,1794092400,1794096000,1794099600,1794103200,1794106800,1794110400,1794114000,1794117600,1794121200,1794124800],"temperature_2m":[0.2,1.3,2.1,2.5,2.9,3.2,3.2,2.4,1.7,1.3,0.9,0.8,0.7,0.6,0.4,0.3,0.3,0.4,0.4,0.2,0.1,0.1,0.2,0.2,0.5],"apparent_temperature":[-2.6,-1.1,-0.5,-0.2,0.1,0.4,0.6,-0.1,-1.1,-1.8,-2.1,-2.1,-2.3,-2.4,-2.3,-2.4,-2.5,-2.2,-2.0,-2.2,-2.4,-2.4,-2.4,-2.5,-2.2],"relative_humidity_2m":[84,80,77,76,75,74,76,80,83,80,80,82,85,87,87,88,94,97,98,98,98,97,95,94,93],"precipitation_probability":[0,0,0,0,0,0,0,0,0,0,0,0,0,0,0,0,0,0,0,0,0,0,0,0,0],"precipitation":[0.00,0.00,0.00,0.00,0.00,0.00,0.00,0.00,0.00,0.00,0.00,0.00,0.00,0.00,0.00,0.00,0.00,0.00,0.00,0.00,0.00,0.00,0.00,0.00,0.00],"weather_code":[1,0,0,0,0,0,1,1,0,0,0,0,1,1,1,1,1,2,2,2,2,3,3,3,3],"cloud_cover":[23,0,0,0,1,15,39,27,14,9,3,10,21,27,24,34,48,56,64,69,76,84,90,91,94],"wind_speed_10m":[2.2,0.7,2.2,2.9,3.2,3.2,2.9,2.2,4.3,5.4,4.3,4.0,4.3,4.3,2.9,2.9,4.3,3.2,2.2,2.2,2.5,2.2,2.9,3.6,3.6],"wind_direction_10m":[25,218,244,243,236,257,274,336,31,34,40,62,112,91,34,182,205,218,213,210,208,179,90,81,74],"wind_gusts_10m":[4.3,4.3,5.8,6.8,7.6,7.6,6.8,5.0,6.1,7.9,7.6,5.8,5.8,6.5,6.1,6.1,7.6,7.9,6.8,5.8,6.1,6.1,6.8,7.9,8.3],"uv_index":[0.10,0.45,0.80,1.00,1.00,0.80,0.45,0.15,0.00,0.00,0.00,0.00,0.00,0.00,0.00,0.00,0.00,0.00,0.00,0.00,0.00,0.00,0.00,0.00,0.10],"is_day":[1,1,1,1,1,1,1,1,0,0,0,0,0,0,0,0,0,0,0,0,0,0,0,1,1]},"daily_units":{"time":"unixtime","weather_code":"wmo code","temperature_2m_max":"°C","temperature_2m_min":"°C","apparent_temperature_max":"°C","apparent_temperature_min":"°C","sunrise":"unixtime","sunset":"unixtime","sunshine_duration":"s","uv_index_max":"","precipitation_sum":"mm","snowfall_sum":"cm","precipitation_hours":"h","precipitation_probability_max":"%","wind_speed_10m_max":"km/h","wind_gusts_10m_max":"km/h","wind_direction_10m_dominant":"°"},"daily":{"time":[1794006000,1794092400,1794178800,1794265200,1794351600,1794438000,1794524400],"weather_code":[3,3,45,45,45,85,45],"temperature_2m_max":[3.3,3.4,4.5,1.3,0.7,0.9,3.0],"temperature_2m_min":[0.1,0.1,0.2,-0.2,-0.7,-3.0,-2.9],"apparent_temperature_max":[0.6,1.4,2.3,-0.9,-2.0,-1.4,-1.7],"apparent_temperature_min":[-2.6,-2.5,-1.9,-2.5,-3.3,-6.2,-5.3],"sunrise":[1794034441,1794120996,1794207551,1794294105,1794380659,1794467211,1794553763],"sunset":[1794063997,1794150251,1794236506,1794322763,1794409023,1794495285,1794581550],"sunshine_duration":[28194.83,0.00,701.40,399.85,26.07,13720.12,23242.98],"uv_index_max":[1.00,0.90,0.95,0.70,0.90,0.75,0.80],"precipitation_sum":[0.00,0.00,0.00,0.00,0.00,1.20,0.00],"snowfall_sum":[0.00,0.00,0.00,0.00,0.00,0.42,0.00],"precipitation_hours":[0.0,0.0,0.0,0.0,0.0,9.0,0.0],"precipitation_probability_max":[0,0,2,4,29,31,26],"wind_speed_10m_max":[5.4,4.7,4.3,2.4,5.9,5.9,13.9],"wind_gusts_10m_max":[7.9,10.1,8.3,9.0,13.0,14.4,30.2],"wind_direction_10m_dominant":[50,101,143,36,173,200,279]}})OM"
