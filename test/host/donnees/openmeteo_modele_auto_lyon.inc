// FICHIER GÉNÉRÉ par test/host/controle_python_modeles.py : ne pas modifier à la main.
// Réponse réelle d'Open-Meteo (auto, Lyon, requête complète du firmware + models=), voir donnees/LISEZMOI.md.
R"OM({"latitude":45.755363,"longitude":4.852546,"generationtime_ms":1.5159845352172852,"utc_offset_seconds":3600,"timezone":"Europe/Paris","timezone_abbreviation":"GMT+1","elevation":176.0,"current_units":{"time":"unixtime","interval":"seconds","temperature_2m":"°C","apparent_temperature":"°C","is_day":"","precipitation":"mm","weather_code":"wmo code","cloud_cover":"%","wind_speed_10m":"km/h","wind_direction_10m":"°","wind_gusts_10m":"km/h","pressure_msl":"hPa","relative_humidity_2m":"%"},"current":{"time":1794040200,"interval":900,"temperature_2m":6.9,"apparent_temperature":4.5,"is_day":1,"precipitation":0.00,"weather_code":3,"cloud_cover":74,"wind_speed_10m":6.3,"wind_direction_10m":294,"wind_gusts_10m":15.8,"pressure_msl":1025.8,"relative_humidity_2m":81},"minutely_15_units":{"time":"unixtime","precipitation":"mm"},"minutely_15":{"time":[1794040200,1794041100,1794042000,1794042900,1794043800,1794044700,1794045600,1794046500,1794047400],"precipitation":[0.00,0.00,0.00,0.00,0.00,0.00,0.00,0.00,0.00]},"hourly_units":{"time":"unixtime","temperature_2m":"°C","apparent_temperature":"°C","relative_humidity_2m":"%","precipitation_probability":"%","precipitation":"mm","weather_code":"wmo code","cloud_cover":"%","wind_speed_10m":"km/h","wind_direction_10m":"°","wind_gusts_10m":"km/h","uv_index":"","is_day":""},"hourly":{"time":[1794038400,1794042000,1794045600,1794049200,1794052800,1794056400,1794060000,1794063600,1794067200,1794070800,1794074400,1794078000,1794081600,1794085200,1794088800,1794092400,1794096000,1794099600,1794103200,1794106800,1794110400,1794114000,1794117600,1794121200,1794124800],"temperature_2m":[6.4,7.5,8.4,9.4,10.3,10.6,10.7,10.7,10.4,10.0,9.2,8.1,7.2,6.4,6.0,5.3,4.8,4.1,3.7,3.3,2.8,3.1,3.2,3.4,3.8],"apparent_temperature":[3.9,5.2,6.3,7.7,8.8,8.9,8.9,8.8,8.5,8.1,7.7,6.7,5.7,4.8,4.3,3.5,3.1,2.2,2.0,1.6,1.0,1.4,1.5,1.7,2.0],"relative_humidity_2m":[84,77,73,68,65,64,65,63,67,68,76,83,90,92,89,91,92,94,97,100,100,100,100,99,97],"precipitation_probability":[0,0,0,0,0,0,0,0,0,0,0,0,0,0,0,0,0,0,0,0,0,0,0,0,3],"precipitation":[0.00,0.00,0.00,0.00,0.00,0.00,0.00,0.00,0.00,0.00,0.00,0.00,0.00,0.00,0.00,0.00,0.00,0.00,0.00,0.00,0.00,0.00,0.00,0.00,0.00],"weather_code":[2,3,2,2,2,2,2,2,2,2,1,0,0,0,0,0,1,45,45,45,45,45,45,45,45],"cloud_cover":[56,92,58,54,67,49,50,52,59,59,23,0,0,0,0,0,0,0,60,93,100,100,95,100,94],"wind_speed_10m":[6.7,5.2,3.9,1.6,0.4,1.8,3.1,3.1,3.6,3.6,2.1,1.3,2.9,2.6,2.3,2.1,1.8,2.6,0.8,0.5,1.1,0.5,0.8,0.7,1.8],"wind_direction_10m":[286,304,326,333,90,53,54,69,84,84,59,326,263,236,219,211,180,164,153,45,18,45,117,180,180],"wind_gusts_10m":[14.0,15.8,11.5,9.0,5.4,6.5,8.3,8.3,6.8,6.5,6.8,4.0,5.0,5.0,5.0,5.0,4.3,5.8,5.4,1.8,3.2,3.2,2.9,2.9,5.0],"uv_index":[0.50,1.30,2.10,2.65,2.85,2.60,1.95,1.15,0.35,0.00,0.00,0.00,0.00,0.00,0.00,0.00,0.00,0.00,0.00,0.00,0.00,0.00,0.00,0.00,0.45],"is_day":[1,1,1,1,1,1,1,1,1,0,0,0,0,0,0,0,0,0,0,0,0,0,0,1,1]},"daily_units":{"time":"unixtime","weather_code":"wmo code","temperature_2m_max":"°C","temperature_2m_min":"°C","apparent_temperature_max":"°C","apparent_temperature_min":"°C","sunrise":"unixtime","sunset":"unixtime","sunshine_duration":"s","uv_index_max":"","precipitation_sum":"mm","snowfall_sum":"cm","precipitation_hours":"h","precipitation_probability_max":"%","wind_speed_10m_max":"km/h","wind_gusts_10m_max":"km/h","wind_direction_10m_dominant":"°"},"daily":{"time":[1794006000,1794092400,1794178800,1794265200,1794351600,1794438000,1794524400],"weather_code":[45,45,61,61,95,95,80],"temperature_2m_max":[10.7,14.1,17.7,19.9,17.6,19.8,16.3],"temperature_2m_min":[5.3,2.8,9.5,13.8,14.0,13.4,9.5],"apparent_temperature_max":[8.9,12.7,14.6,19.7,18.1,20.0,16.5],"apparent_temperature_min":[3.4,1.0,8.8,13.7,14.2,14.0,7.1],"sunrise":[1794032936,1794119422,1794205908,1794292393,1794378879,1794465363,1794551848],"sunset":[1794068347,1794154670,1794240994,1794327319,1794413647,1794499977,1794586309],"sunshine_duration":[32400.00,18063.03,7060.19,30035.82,0.00,27863.62,14975.47],"uv_index_max":[2.85,2.40,2.20,2.30,2.35,0.35,0.35],"precipitation_sum":[0.00,0.00,2.50,1.00,5.80,4.70,5.40],"snowfall_sum":[0.00,0.00,0.00,0.00,0.00,0.00,0.00],"precipitation_hours":[0.0,0.0,6.0,5.0,16.0,5.0,15.0],"precipitation_probability_max":[0,15,76,89,45,39,41],"wind_speed_10m_max":[6.7,9.5,23.5,13.7,8.2,10.1,14.5],"wind_gusts_10m_max":[15.8,22.3,54.7,33.5,21.2,22.3,32.8],"wind_direction_10m_dominant":[333,184,174,172,128,174,341]}})OM"
