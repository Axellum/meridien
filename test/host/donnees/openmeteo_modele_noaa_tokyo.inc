// FICHIER GÉNÉRÉ par test/host/controle_python_modeles.py : ne pas modifier à la main.
// Réponse réelle d'Open-Meteo (noaa, Tokyo, requête complète du firmware + models=), voir donnees/LISEZMOI.md.
R"OM({"latitude":35.67198,"longitude":139.6875,"generationtime_ms":0.6607770919799805,"utc_offset_seconds":32400,"timezone":"Asia/Tokyo","timezone_abbreviation":"GMT+9","elevation":43.0,"current_units":{"time":"unixtime","interval":"seconds","temperature_2m":"°C","apparent_temperature":"°C","is_day":"","precipitation":"mm","weather_code":"wmo code","cloud_cover":"%","wind_speed_10m":"km/h","wind_direction_10m":"°","wind_gusts_10m":"km/h","pressure_msl":"hPa","relative_humidity_2m":"%"},"current":{"time":1794040200,"interval":900,"temperature_2m":15.5,"apparent_temperature":9.4,"is_day":0,"precipitation":0.00,"weather_code":0,"cloud_cover":5,"wind_speed_10m":27.3,"wind_direction_10m":348,"wind_gusts_10m":29.9,"pressure_msl":1023.5,"relative_humidity_2m":35},"minutely_15_units":{"time":"unixtime","precipitation":"mm"},"minutely_15":{"time":[1794040200,1794041100,1794042000,1794042900,1794043800,1794044700,1794045600,1794046500,1794047400],"precipitation":[0.00,0.00,0.00,0.00,0.00,0.00,0.00,0.00,0.00]},"hourly_units":{"time":"unixtime","temperature_2m":"°C","apparent_temperature":"°C","relative_humidity_2m":"%","precipitation_probability":"%","precipitation":"mm","weather_code":"wmo code","cloud_cover":"%","wind_speed_10m":"km/h","wind_direction_10m":"°","wind_gusts_10m":"km/h","uv_index":"","is_day":""},"hourly":{"time":[1794038400,1794042000,1794045600,1794049200,1794052800,1794056400,1794060000,1794063600,1794067200,1794070800,1794074400,1794078000,1794081600,1794085200,1794088800,1794092400,1794096000,1794099600,1794103200,1794106800,1794110400,1794114000,1794117600,1794121200,1794124800],"temperature_2m":[16.2,15.0,14.4,13.8,13.4,13.2,13.0,12.7,12.4,11.9,11.8,11.7,11.6,11.4,11.2,11.8,12.6,13.0,13.7,14.4,14.9,15.2,15.6,15.5,14.2],"apparent_temperature":[10.1,8.9,8.3,7.7,7.8,7.9,7.6,7.3,7.0,5.9,5.5,4.9,4.7,4.8,4.6,5.6,6.8,7.6,8.8,9.8,11.1,11.6,12.0,11.5,9.8],"relative_humidity_2m":[34,36,37,41,42,44,45,45,46,47,46,44,42,42,42,40,37,35,33,31,30,30,29,30,40],"precipitation_probability":[0,0,0,0,0,0,0,0,0,0,0,0,0,0,0,0,0,0,0,0,0,0,0,0,0],"precipitation":[0.00,0.00,0.00,0.00,0.00,0.00,0.00,0.00,0.00,0.00,0.00,0.00,0.00,0.00,0.00,0.00,0.00,0.00,0.00,0.00,0.00,0.00,0.00,0.00,0.00],"weather_code":[0,0,0,0,1,2,3,3,3,3,3,3,3,3,3,0,1,3,3,3,3,3,3,3,3],"cloud_cover":[5,5,5,0,33,57,100,100,100,86,100,100,100,100,100,5,41,100,100,100,100,100,100,100,100],"wind_speed_10m":[27.1,27.1,27.0,27.8,24.6,23.3,23.9,23.7,23.0,27.0,28.8,31.7,31.8,29.6,29.5,26.0,23.5,19.9,16.6,14.1,8.7,7.5,7.3,10.9,16.5],"wind_direction_10m":[349,346,347,350,354,351,349,346,343,344,342,345,350,355,360,4,5,4,5,4,17,55,99,124,134],"wind_gusts_10m":[28.4,31.3,33.8,36.0,32.4,29.5,29.5,29.9,32.0,41.0,42.5,45.0,42.5,38.9,36.0,30.2,24.8,19.8,17.3,14.8,10.4,7.6,5.8,5.4,11.5],"uv_index":[0.10,0.00,0.00,0.00,0.00,0.00,0.00,0.00,0.00,0.00,0.00,0.00,0.00,0.00,0.10,1.00,2.15,1.85,2.25,1.80,1.05,0.95,1.85,0.45,0.00],"is_day":[0,0,0,0,0,0,0,0,0,0,0,0,0,0,1,1,1,1,1,1,1,1,1,1,0]},"daily_units":{"time":"unixtime","weather_code":"wmo code","temperature_2m_max":"°C","temperature_2m_min":"°C","apparent_temperature_max":"°C","apparent_temperature_min":"°C","sunrise":"unixtime","sunset":"unixtime","sunshine_duration":"s","uv_index_max":"","precipitation_sum":"mm","snowfall_sum":"cm","precipitation_hours":"h","precipitation_probability_max":"%","wind_speed_10m_max":"km/h","wind_gusts_10m_max":"km/h","wind_direction_10m_dominant":"°"},"daily":{"time":[1793977200,1794063600,1794150000,1794236400,1794322800,1794409200,1794495600],"weather_code":[3,3,51,3,3,3,3],"temperature_2m_max":[20.3,15.6,14.0,15.5,16.3,16.2,18.6],"temperature_2m_min":[12.7,11.2,11.6,11.4,11.2,12.1,13.3],"apparent_temperature_max":[15.7,12.0,11.2,11.4,14.6,14.2,15.3],"apparent_temperature_min":[7.6,4.6,7.7,5.1,7.8,8.8,11.0],"sunrise":[1793999320,1794085779,1794172239,1794258699,1794345159,1794431619,1794518079],"sunset":[1794037251,1794123598,1794209947,1794296298,1794382650,1794469004,1794555360],"sunshine_duration":[37405.77,23910.01,0.00,12665.53,36135.36,29432.03,34854.68],"uv_index_max":[4.35,2.25,0.75,2.50,4.10,2.45,3.05],"precipitation_sum":[0.00,0.00,0.30,0.00,0.00,0.00,0.00],"snowfall_sum":[0.00,0.00,0.00,0.00,0.00,0.00,0.00],"precipitation_hours":[0.0,0.0,3.0,0.0,0.0,0.0,0.0],"precipitation_probability_max":[0,12,87,33,3,6,6],"wind_speed_10m_max":[28.6,31.8,21.3,30.4,14.3,17.5,11.2],"wind_gusts_10m_max":[40.0,45.0,25.2,47.2,17.3,19.8,15.5],"wind_direction_10m_dominant":[346,8,4,1,34,25,353]}})OM"
