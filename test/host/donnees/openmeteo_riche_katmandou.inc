// FICHIER GÉNÉRÉ par test/host/controle_python_riche.py : ne pas modifier à la main.
// Réponse réelle d'Open-Meteo (katmandou, requête du firmware), voir donnees/LISEZMOI.md.
R"OM({"latitude":27.732864,"longitude":85.34831,"generationtime_ms":0.5336999893188477,"utc_offset_seconds":20700,"timezone":"Asia/Kathmandu","timezone_abbreviation":"GMT+5:45","elevation":1301.0,"current_units":{"time":"unixtime","interval":"seconds","temperature_2m":"°C","apparent_temperature":"°C","is_day":"","precipitation":"mm","weather_code":"wmo code","cloud_cover":"%","wind_speed_10m":"km/h","wind_direction_10m":"°","wind_gusts_10m":"km/h","pressure_msl":"hPa","relative_humidity_2m":"%"},"current":{"time":1794006000,"interval":900,"temperature_2m":10.6,"apparent_temperature":9.9,"is_day":0,"precipitation":0.00,"weather_code":45,"cloud_cover":100,"wind_speed_10m":6.1,"wind_direction_10m":152,"wind_gusts_10m":15.5,"pressure_msl":1016.7,"relative_humidity_2m":100},"minutely_15_units":{"time":"unixtime","precipitation":"mm"},"minutely_15":{"time":[1794003300,1794004200,1794005100,1794006000,1794006900,1794007800,1794008700,1794009600,1794010500],"precipitation":[0.00,0.00,0.00,0.00,0.00,0.00,0.00,0.00,0.00]},"hourly_units":{"time":"unixtime","temperature_2m":"°C","apparent_temperature":"°C","relative_humidity_2m":"%","precipitation_probability":"%","precipitation":"mm","weather_code":"wmo code","cloud_cover":"%","wind_speed_10m":"km/h","wind_direction_10m":"°","wind_gusts_10m":"km/h","uv_index":"","is_day":""},"hourly":{"time":[1794003300,1794006900,1794010500,1794014100,1794017700,1794021300,1794024900,1794028500,1794032100,1794035700,1794039300,1794042900,1794046500,1794050100,1794053700,1794057300,1794060900,1794064500,1794068100,1794071700,1794075300,1794078900,1794082500,1794086100,1794089700],"temperature_2m":[10.6,10.8,11.1,14.4,17.9,19.8,21.1,22.0,22.5,22.4,21.9,20.5,18.9,17.3,16.7,16.3,15.9,15.7,15.6,15.6,15.4,15.1,14.9,14.5,13.8],"apparent_temperature":[9.9,10.0,10.5,14.4,18.4,20.5,22.0,23.3,23.8,23.0,21.4,20.5,19.7,18.6,17.9,17.4,17.0,16.7,16.5,16.3,16.0,15.5,15.2,14.6,13.8],"relative_humidity_2m":[100,100,100,91,75,68,60,57,54,53,48,61,76,86,87,86,85,85,84,83,83,83,84,86,89],"precipitation_probability":[0,0,0,0,0,0,0,0,17,40,53,46,29,14,7,3,0,0,0,0,0,0,0,0,0],"precipitation":[0.00,0.00,0.00,0.00,0.00,0.00,0.00,0.00,0.00,0.10,0.20,0.60,0.00,0.00,0.00,0.00,0.00,0.00,0.00,0.00,0.00,0.00,0.00,0.00,0.00],"weather_code":[45,45,45,45,0,0,0,0,2,51,51,53,0,0,0,0,0,0,0,0,0,0,0,0,0],"cloud_cover":[100,100,97,9,3,7,10,12,70,41,42,28,16,6,4,4,5,5,4,2,1,0,0,0,0],"wind_speed_10m":[6.1,7.0,6.9,6.2,4.0,3.5,3.1,3.1,1.3,1.5,4.5,5.9,4.7,2.9,1.8,1.5,0.7,0.7,0.7,1.1,1.5,2.3,3.1,3.7,4.4],"wind_direction_10m":[152,151,150,139,108,99,83,69,90,300,284,297,302,263,225,201,194,180,180,180,173,162,156,157,153],"wind_gusts_10m":[15.5,15.8,15.8,15.8,14.4,14.8,17.3,18.4,17.3,13.3,15.1,16.6,16.2,10.8,7.2,5.8,5.0,3.6,3.6,4.0,4.3,6.1,8.3,9.7,11.2],"uv_index":[0.00,0.00,0.05,0.75,2.15,3.75,5.10,5.85,5.85,5.15,3.85,2.05,0.55,0.05,0.00,0.00,0.00,0.00,0.00,0.00,0.00,0.00,0.00,0.00,0.00],"is_day":[0,0,1,1,1,1,1,1,1,1,1,1,1,0,0,0,0,0,0,0,0,0,0,0,0]},"daily_units":{"time":"unixtime","weather_code":"wmo code","temperature_2m_max":"°C","temperature_2m_min":"°C","apparent_temperature_max":"°C","apparent_temperature_min":"°C","sunrise":"unixtime","sunset":"unixtime","sunshine_duration":"s","uv_index_max":"","precipitation_sum":"mm","snowfall_sum":"cm","precipitation_hours":"h","precipitation_probability_max":"%","wind_speed_10m_max":"km/h","wind_gusts_10m_max":"km/h","wind_direction_10m_dominant":"°"},"daily":{"time":[1793988900,1794075300,1794161700,1794248100,1794334500,1794420900,1794507300],"weather_code":[53,51,1,1,53,45,45],"temperature_2m_max":[22.5,22.1,22.9,23.2,22.0,20.3,20.5],"temperature_2m_min":[10.6,12.8,13.4,14.0,13.6,9.5,9.2],"apparent_temperature_max":[23.8,23.7,22.2,22.6,21.1,19.5,20.4],"apparent_temperature_min":[9.9,12.6,12.7,12.8,12.3,11.0,7.9],"sunrise":[1794011611,1794098055,1794184500,1794270945,1794357390,1794443835,1794530280],"sunset":[1794051048,1794137411,1794223776,1794310142,1794396509,1794482878,1794569248],"sunshine_duration":[36000.00,36000.00,36000.00,36079.00,36000.00,36000.00,36015.95],"uv_index_max":[5.85,5.85,5.75,5.70,5.65,5.30,5.40],"precipitation_sum":[0.90,0.80,0.00,0.00,1.50,0.00,0.00],"snowfall_sum":[0.00,0.00,0.00,0.00,0.00,0.00,0.00],"precipitation_hours":[3.0,4.0,0.0,0.0,3.0,0.0,0.0],"precipitation_probability_max":[53,59,6,4,41,20,8],"wind_speed_10m_max":[7.0,6.6,8.6,5.4,8.3,6.0,5.6],"wind_gusts_10m_max":[18.4,21.2,24.1,16.2,24.8,21.2,20.2],"wind_direction_10m_dominant":[160,147,120,150,235,90,203]}})OM"
