// FICHIER GÉNÉRÉ par test/host/controle_python_modeles.py : ne pas modifier à la main.
// Réponse réelle d'Open-Meteo (metno, Copenhague, requête complète du firmware + models=), voir donnees/LISEZMOI.md.
R"OM({"latitude":55.6785,"longitude":12.570435,"generationtime_ms":0.5911588668823242,"utc_offset_seconds":3600,"timezone":"Europe/Copenhagen","timezone_abbreviation":"GMT+1","elevation":10.0,"current_units":{"time":"unixtime","interval":"seconds","temperature_2m":"°C","apparent_temperature":"°C","is_day":"","precipitation":"mm","weather_code":"wmo code","cloud_cover":"%","wind_speed_10m":"km/h","wind_direction_10m":"°","wind_gusts_10m":"km/h","pressure_msl":"hPa","relative_humidity_2m":"%"},"current":{"time":1794040200,"interval":900,"temperature_2m":8.8,"apparent_temperature":7.1,"is_day":1,"precipitation":0.00,"weather_code":3,"cloud_cover":86,"wind_speed_10m":2.2,"wind_direction_10m":254,"wind_gusts_10m":6.8,"pressure_msl":1029.7,"relative_humidity_2m":72},"minutely_15_units":{"time":"unixtime","precipitation":"mm"},"minutely_15":{"time":[1794040200,1794041100,1794042000,1794042900,1794043800,1794044700,1794045600,1794046500,1794047400],"precipitation":[0.00,0.00,0.00,0.00,0.00,0.00,0.00,0.00,0.00]},"hourly_units":{"time":"unixtime","temperature_2m":"°C","apparent_temperature":"°C","relative_humidity_2m":"%","precipitation_probability":"%","precipitation":"mm","weather_code":"wmo code","cloud_cover":"%","wind_speed_10m":"km/h","wind_direction_10m":"°","wind_gusts_10m":"km/h","uv_index":"","is_day":""},"hourly":{"time":[1794038400,1794042000,1794045600,1794049200,1794052800,1794056400,1794060000,1794063600,1794067200,1794070800,1794074400,1794078000,1794081600,1794085200,1794088800,1794092400,1794096000,1794099600,1794103200,1794106800,1794110400,1794114000,1794117600,1794121200,1794124800],"temperature_2m":[8.6,9.1,9.7,9.9,10.1,10.0,9.8,9.3,8.9,8.5,8.1,8.1,7.7,7.7,7.7,7.8,7.6,7.6,7.4,7.3,7.2,7.1,7.1,7.0,7.2],"apparent_temperature":[6.9,7.2,6.9,7.1,7.2,7.1,6.7,5.9,5.6,5.1,4.6,4.3,4.3,4.2,4.3,4.3,3.9,4.1,3.9,3.7,3.7,3.6,3.4,3.3,3.6],"relative_humidity_2m":[74,70,60,61,62,63,62,64,66,67,70,70,74,74,75,75,74,74,76,76,77,77,78,78,77],"precipitation_probability":[0,0,0,0,0,0,0,0,0,0,0,0,0,0,0,0,0,0,0,0,0,0,0,0,0],"precipitation":[0.00,0.00,0.00,0.00,0.00,0.00,0.00,0.00,0.00,0.00,0.00,0.00,0.00,0.00,0.00,0.00,0.00,0.00,0.00,0.00,0.00,0.00,0.00,0.00,0.00],"weather_code":[3,3,2,3,2,2,2,3,3,2,2,2,2,3,3,3,3,2,2,3,2,2,3,3,3],"cloud_cover":[85,86,76,81,73,64,77,89,82,65,53,54,69,89,94,95,93,74,68,80,73,71,86,94,99],"wind_speed_10m":[1.8,2.9,6.8,7.9,8.6,9.4,10.4,12.2,10.8,11.9,12.2,14.4,13.0,13.3,13.3,13.7,14.4,13.0,13.7,13.7,13.3,13.0,14.4,14.8,14.0],"wind_direction_10m":[321,187,178,148,139,145,136,124,128,131,128,127,119,119,120,118,118,120,116,120,123,117,117,120,122],"wind_gusts_10m":[6.1,8.3,16.6,17.6,19.1,20.2,20.5,22.7,22.3,22.3,22.3,26.3,26.3,24.8,24.8,25.6,27.0,27.0,24.8,25.9,25.2,24.8,26.6,28.1,28.1],"uv_index":[0.35,0.80,1.20,1.45,1.40,1.15,0.70,0.25,0.00,0.00,0.00,0.00,0.00,0.00,0.00,0.00,0.00,0.00,0.00,0.00,0.00,0.00,0.00,0.00,0.30],"is_day":[1,1,1,1,1,1,1,1,0,0,0,0,0,0,0,0,0,0,0,0,0,0,0,1,1]},"daily_units":{"time":"unixtime","weather_code":"wmo code","temperature_2m_max":"°C","temperature_2m_min":"°C","apparent_temperature_max":"°C","apparent_temperature_min":"°C","sunrise":"unixtime","sunset":"unixtime","sunshine_duration":"s","uv_index_max":"","precipitation_sum":"mm","snowfall_sum":"cm","precipitation_hours":"h","precipitation_probability_max":"%","wind_speed_10m_max":"km/h","wind_gusts_10m_max":"km/h","wind_direction_10m_dominant":"°"},"daily":{"time":[1794006000,1794092400,1794178800,1794265200,1794351600,1794438000,1794524400],"weather_code":[3,3,55,53,51,51,0],"temperature_2m_max":[10.1,8.5,8.8,8.1,7.4,8.3,7.6],"temperature_2m_min":[7.7,7.0,6.4,5.6,5.8,5.2,4.5],"apparent_temperature_max":[7.2,5.6,6.6,5.3,3.7,4.4,2.7],"apparent_temperature_min":[4.2,3.3,4.2,2.6,2.4,0.8,0.1],"sunrise":[1794032882,1794119409,1794205935,1794292462,1794378987,1794465512,1794552036],"sunset":[1794064685,1794150967,1794237250,1794323535,1794409823,1794496113,1794582406],"sunshine_duration":[15188.91,1093.43,0.00,21975.51,0.00,28270.02,28789.40],"uv_index_max":[1.45,1.40,0.75,1.35,1.00,1.15,0.80],"precipitation_sum":[0.00,0.00,3.03,1.10,0.10,1.70,0.00],"snowfall_sum":[0.00,0.00,0.00,0.00,0.00,0.00,0.00],"precipitation_hours":[0.0,0.0,10.0,5.0,1.0,11.0,0.0],"precipitation_probability_max":[0,0,7,10,16,33,27],"wind_speed_10m_max":[14.4,14.8,11.2,13.7,16.0,19.0,20.0],"wind_gusts_10m_max":[26.3,28.1,21.6,27.7,33.1,40.3,49.7],"wind_direction_10m_dominant":[137,139,159,267,203,265,269]}})OM"
