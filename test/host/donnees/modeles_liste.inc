// FICHIER GÉNÉRÉ par test/host/controle_python_modeles.py : ne pas modifier à la main.
// id, ville, pays, instant de réception, limites, accepté, heures, jours, quarts, puis la réponse.
// accepté = 1 si le lecteur du firmware garde la réponse ; heures/jours/quarts = -1 quand elle est refusée.
{"auto", "Lyon", "FR", 1794040300LL, 0, 1, 24, 7, 9,
#include "openmeteo_modele_auto_lyon.inc"
},
{"meteofrance", "Lyon", "FR", 1794040300LL, 13, 0, -1, -1, -1,
#include "openmeteo_modele_meteofrance_lyon.inc"
},
{"meteofrance", "Saint-Denis (La Réunion)", "RE", 1794040300LL, 13, 0, -1, -1, -1,
#include "openmeteo_modele_meteofrance_saint_denis_la_reunion.inc"
},
{"dwd", "Berlin", "DE", 1794040300LL, 1, 0, -1, -1, -1,
#include "openmeteo_modele_dwd_berlin.inc"
},
{"metoffice", "Londres", "GB", 1794040300LL, 17, 0, -1, -1, -1,
#include "openmeteo_modele_metoffice_londres.inc"
},
{"metno", "Oslo", "NO", 1794040300LL, 0, 1, 24, 7, 9,
#include "openmeteo_modele_metno_oslo.inc"
},
{"metno", "Stockholm", "SE", 1794040300LL, 0, 1, 24, 7, 9,
#include "openmeteo_modele_metno_stockholm.inc"
},
{"metno", "Helsinki", "FI", 1794040300LL, 0, 1, 24, 7, 9,
#include "openmeteo_modele_metno_helsinki.inc"
},
{"metno", "Copenhague", "DK", 1794040300LL, 0, 1, 24, 7, 9,
#include "openmeteo_modele_metno_copenhague.inc"
},
{"metno", "Reykjavik", "IS", 1794040300LL, 0, 1, 24, 7, 9,
#include "openmeteo_modele_metno_reykjavik.inc"
},
{"metno", "Tallinn", "EE", 1794040300LL, 0, 1, 24, 7, 9,
#include "openmeteo_modele_metno_tallinn.inc"
},
{"dmi", "Copenhague", "DK", 1794040300LL, 1, 0, -1, -1, -1,
#include "openmeteo_modele_dmi_copenhague.inc"
},
{"knmi", "Amsterdam", "NL", 1794040300LL, 0, 1, 24, 7, 9,
#include "openmeteo_modele_knmi_amsterdam.inc"
},
{"knmi", "Bruxelles", "BE", 1794040300LL, 0, 1, 24, 7, 9,
#include "openmeteo_modele_knmi_bruxelles.inc"
},
{"knmi", "Luxembourg", "LU", 1794040300LL, 0, 1, 24, 7, 9,
#include "openmeteo_modele_knmi_luxembourg.inc"
},
{"meteosuisse", "Berne", "CH", 1794040300LL, 9, 0, -1, -1, -1,
#include "openmeteo_modele_meteosuisse_berne.inc"
},
{"jma", "Tokyo", "JP", 1794040300LL, 23, 0, -1, -1, -1,
#include "openmeteo_modele_jma_tokyo.inc"
},
{"gem", "Ottawa", "CA", 1794040300LL, 1, 0, -1, -1, -1,
#include "openmeteo_modele_gem_ottawa.inc"
},
{"geosphere", "Vienne", "AT", 1794040300LL, 1, 0, -1, -1, -1,
#include "openmeteo_modele_geosphere_vienne.inc"
},
{"arpae", "Rome", "IT", 1794040300LL, 13, 0, -1, -1, -1,
#include "openmeteo_modele_arpae_rome.inc"
},
{"chmi", "Prague", "CZ", 1794040300LL, 1, 0, -1, -1, -1,
#include "openmeteo_modele_chmi_prague.inc"
},
{"noaa", "New York", "US", 1794040300LL, 0, 1, 24, 7, 9,
#include "openmeteo_modele_noaa_new_york.inc"
},
{"noaa", "Lyon", "FR", 1794040300LL, 0, 1, 24, 7, 9,
#include "openmeteo_modele_noaa_lyon.inc"
},
{"noaa", "Tokyo", "JP", 1794040300LL, 0, 1, 24, 7, 9,
#include "openmeteo_modele_noaa_tokyo.inc"
},
{"noaa", "Sydney", "AU", 1794040300LL, 0, 1, 24, 7, 9,
#include "openmeteo_modele_noaa_sydney.inc"
},
{"noaa", "Sao Paulo", "BR", 1794040300LL, 0, 1, 24, 7, 9,
#include "openmeteo_modele_noaa_sao_paulo.inc"
},
{"noaa", "Le Cap", "ZA", 1794040300LL, 0, 1, 24, 7, 9,
#include "openmeteo_modele_noaa_le_cap.inc"
},
{"noaa", "Ottawa", "CA", 1794040300LL, 0, 1, 24, 7, 9,
#include "openmeteo_modele_noaa_ottawa.inc"
},
{"ecmwf", "Istanbul", "TR", 1794040300LL, 1, 0, -1, -1, -1,
#include "openmeteo_modele_ecmwf_istanbul.inc"
},
