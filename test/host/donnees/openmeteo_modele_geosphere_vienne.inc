// FICHIER GÉNÉRÉ par test/host/controle_python_modeles.py : ne pas modifier à la main.
// Réponse réelle d'Open-Meteo (geosphere, Vienne, requête complète du firmware + models=), voir donnees/LISEZMOI.md.
R"OM({"latitude":48.204002,"longitude":16.3717,"generationtime_ms":1.0669231414794922,"utc_offset_seconds":3600,"timezone":"Europe/Vienna","timezone_abbreviation":"GMT+1","elevation":192.0,"current_units":{"time":"unixtime","interval":"seconds","temperature_2m":"°C","apparent_temperature":"°C","is_day":"","precipitation":"mm","weather_code":"wmo code","cloud_cover":"%","wind_speed_10m":"km/h","wind_direction_10m":"°","wind_gusts_10m":"km/h","pressure_msl":"hPa","relative_humidity_2m":"%"},"current":{"time":1794040200,"interval":900,"temperature_2m":3.6,"apparent_temperature":0.3,"is_day":1,"precipitation":0.00,"weather_code":0,"cloud_cover":6,"wind_speed_10m":6.5,"wind_direction_10m":131,"wind_gusts_10m":15.1,"pressure_msl":1029.7,"relative_humidity_2m":72},"minutely_15_units":{"time":"unixtime","precipitation":"mm"},"minutely_15":{"time":[1794040200,1794041100,1794042000,1794042900,1794043800,1794044700,1794045600,1794046500,1794047400],"precipitation":[0.00,0.00,0.00,0.00,0.00,0.00,0.00,0.00,0.00]},"hourly_units":{"time":"unixtime","temperature_2m":"°C","apparent_temperature":"°C","relative_humidity_2m":"%","precipitation_probability":"%","precipitation":"mm","weather_code":"wmo code","cloud_cover":"%","wind_speed_10m":"km/h","wind_direction_10m":"°","wind_gusts_10m":"km/h","uv_index":"undefined","is_day":""},"hourly":{"time":[1794038400,1794042000,1794045600,1794049200,1794052800,1794056400,1794060000,1794063600,1794067200,1794070800,1794074400,1794078000,1794081600,1794085200,1794088800,1794092400,1794096000,1794099600,1794103200,1794106800,1794110400,1794114000,1794117600,1794121200,1794124800],"temperature_2m":[2.7,4.4,6.4,7.7,8.3,8.6,8.3,7.6,6.6,5.2,4.3,3.5,3.1,2.6,2.1,2.3,2.1,1.7,1.3,0.8,-0.1,0.1,0.9,1.5,2.5],"apparent_temperature":[-0.4,1.1,2.7,3.8,4.2,4.3,4.2,3.9,3.0,1.6,1.0,0.2,-0.2,-0.6,-1.2,-1.3,-1.4,-1.5,-1.8,-2.3,-3.0,-3.2,-2.4,-2.1,-0.9],"relative_humidity_2m":[76,69,64,60,57,54,54,56,61,65,72,77,78,79,81,81,82,82,82,83,82,85,81,79,76],"precipitation_probability":[0,0,0,0,0,0,0,0,0,0,0,0,0,0,0,0,0,0,0,0,1,2,2,1,1],"precipitation":[0.00,0.00,0.00,0.00,0.00,0.00,0.00,0.00,0.00,0.00,0.00,0.00,0.00,0.00,0.00,0.00,0.00,0.00,0.00,0.00,0.00,0.00,0.00,0.00,0.00],"weather_code":[1,0,0,0,0,0,0,0,0,0,0,0,0,0,0,0,0,0,0,0,0,3,3,1,3],"cloud_cover":[16,5,0,0,0,0,0,0,0,0,0,0,0,2,5,6,6,6,7,7,10,92,95,22,98],"wind_speed_10m":[5.4,7.6,10.4,12.6,13.7,14.4,12.6,10.4,9.7,9.0,7.6,7.9,7.9,6.5,6.8,9.0,8.6,6.1,4.7,4.3,3.2,5.8,5.4,8.3,7.2],"wind_direction_10m":[123,139,125,123,125,124,129,127,115,127,141,143,150,144,129,136,136,135,120,99,35,38,99,121,118],"wind_gusts_10m":[13.7,16.6,22.3,26.3,27.7,28.8,29.2,25.6,20.9,19.4,17.6,14.0,15.8,13.7,12.2,16.2,17.3,15.1,9.7,8.6,7.6,8.6,10.8,16.6,16.9],"uv_index":[null,null,null,null,null,null,null,null,null,null,null,null,null,null,null,null,null,null,null,null,null,null,null,null,null],"is_day":[1,1,1,1,1,1,1,1,0,0,0,0,0,0,0,0,0,0,0,0,0,0,1,1,1]},"daily_units":{"time":"unixtime","weather_code":"wmo code","temperature_2m_max":"°C","temperature_2m_min":"°C","apparent_temperature_max":"°C","apparent_temperature_min":"°C","sunrise":"unixtime","sunset":"unixtime","sunshine_duration":"s","uv_index_max":"undefined","precipitation_sum":"mm","snowfall_sum":"cm","precipitation_hours":"h","precipitation_probability_max":"%","wind_speed_10m_max":"km/h","wind_gusts_10m_max":"km/h","wind_direction_10m_dominant":"°"},"daily":{"time":[1794006000,1794092400,1794178800,1794265200,1794351600,1794438000,1794524400],"weather_code":[3,3,3,51,51,53,55],"temperature_2m_max":[8.6,7.4,8.3,7.1,8.9,12.9,13.7],"temperature_2m_min":[-0.6,-0.7,1.5,2.5,3.4,5.8,4.2],"apparent_temperature_max":[4.3,3.5,4.8,5.4,6.6,10.2,11.4],"apparent_temperature_min":[-3.5,-3.2,-1.1,-0.4,1.1,4.3,1.1],"sunrise":[1794030540,1794117034,1794203528,1794290022,1794376515,1794463008,1794549499],"sunset":[1794065211,1794151525,1794237841,1794324159,1794410479,1794496801,1794583125],"sunshine_duration":[27257.00,2758.00,25452.00,0.00,0.00,12207.98,0.00],"uv_index_max":[null,null,null,null,null,null,null],"precipitation_sum":[0.00,0.00,0.00,0.40,0.90,1.70,15.60],"snowfall_sum":[0.00,0.00,0.00,0.00,0.00,0.00,0.00],"precipitation_hours":[0.0,0.0,0.0,3.0,6.0,4.0,24.0],"precipitation_probability_max":[0,2,6,31,13,9,53],"wind_speed_10m_max":[14.4,12.2,12.7,9.9,13.2,12.7,20.9],"wind_gusts_10m_max":[29.2,25.9,26.6,20.5,33.1,30.2,49.3],"wind_direction_10m_dominant":[127,119,127,94,119,142,257]}})OM"
