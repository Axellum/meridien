// FICHIER GÉNÉRÉ par test/host/controle_python_riche.py : ne pas modifier à la main.
// Réponse réelle d'Open-Meteo (singapour, requête du firmware), voir donnees/LISEZMOI.md.
R"OM({"latitude":1.3005272,"longitude":103.862564,"generationtime_ms":0.5508661270141602,"utc_offset_seconds":28800,"timezone":"Asia/Singapore","timezone_abbreviation":"GMT+8","elevation":27.0,"current_units":{"time":"unixtime","interval":"seconds","temperature_2m":"°C","apparent_temperature":"°C","is_day":"","precipitation":"mm","weather_code":"wmo code","cloud_cover":"%","wind_speed_10m":"km/h","wind_direction_10m":"°","wind_gusts_10m":"km/h","pressure_msl":"hPa","relative_humidity_2m":"%"},"current":{"time":1794006000,"interval":900,"temperature_2m":24.6,"apparent_temperature":30.0,"is_day":1,"precipitation":0.00,"weather_code":45,"cloud_cover":53,"wind_speed_10m":2.7,"wind_direction_10m":312,"wind_gusts_10m":5.8,"pressure_msl":1011.5,"relative_humidity_2m":94},"minutely_15_units":{"time":"unixtime","precipitation":"mm"},"minutely_15":{"time":[1794006000,1794006900,1794007800,1794008700,1794009600,1794010500,1794011400,1794012300,1794013200],"precipitation":[0.00,0.00,0.00,0.00,0.00,0.00,0.00,0.00,0.00]},"hourly_units":{"time":"unixtime","temperature_2m":"°C","apparent_temperature":"°C","relative_humidity_2m":"%","precipitation_probability":"%","precipitation":"mm","weather_code":"wmo code","cloud_cover":"%","wind_speed_10m":"km/h","wind_direction_10m":"°","wind_gusts_10m":"km/h","uv_index":"","is_day":""},"hourly":{"time":[1794006000,1794009600,1794013200,1794016800,1794020400,1794024000,1794027600,1794031200,1794034800,1794038400,1794042000,1794045600,1794049200,1794052800,1794056400,1794060000,1794063600,1794067200,1794070800,1794074400,1794078000,1794081600,1794085200,1794088800,1794092400],"temperature_2m":[24.6,25.7,27.0,28.5,29.2,30.1,30.2,30.1,30.1,29.8,29.6,28.7,27.7,26.7,26.5,26.4,26.2,26.0,25.7,25.3,25.3,25.2,24.9,24.8,24.9],"apparent_temperature":[30.0,31.0,32.4,34.2,34.8,36.8,37.2,37.3,36.6,35.3,34.8,34.1,33.5,32.7,32.8,32.8,32.5,32.0,31.2,30.5,30.5,30.4,29.8,29.6,29.9],"relative_humidity_2m":[94,90,83,76,72,68,68,69,68,69,70,75,85,92,93,94,95,95,94,94,93,93,93,95,95],"precipitation_probability":[18,10,7,6,10,19,31,45,62,81,90,83,66,49,32,14,2,0,0,2,1,0,2,8,17],"precipitation":[0.00,0.00,0.00,0.00,0.00,0.00,0.10,0.10,0.20,0.10,0.20,0.20,0.10,0.00,0.00,0.00,0.00,0.00,0.00,0.00,0.00,0.00,0.00,0.60,0.10],"weather_code":[45,45,3,2,1,1,51,51,51,51,51,51,51,1,2,1,1,2,2,1,1,1,45,53,51],"cloud_cover":[53,99,98,63,48,30,23,27,30,32,83,83,67,36,74,41,27,50,52,29,27,30,52,30,23],"wind_speed_10m":[2.7,4.3,4.2,1.5,1.3,5.0,7.4,6.0,6.0,7.1,4.7,4.0,5.3,5.9,3.6,3.5,3.9,4.7,6.3,7.0,6.0,5.6,7.1,8.5,7.5],"wind_direction_10m":[312,312,275,256,98,120,124,129,134,124,92,5,350,333,340,12,347,337,325,337,355,356,10,29,30],"wind_gusts_10m":[5.8,11.9,12.6,13.7,10.4,17.3,22.3,23.8,19.8,21.6,20.5,14.0,10.4,12.6,11.2,6.5,7.6,8.6,11.9,13.7,13.0,12.6,13.0,15.8,16.6],"uv_index":[0.00,0.55,2.25,3.00,5.70,8.05,8.75,8.55,7.35,5.50,3.45,1.50,0.20,0.00,0.00,0.00,0.00,0.00,0.00,0.00,0.00,0.00,0.00,0.00,0.00],"is_day":[1,1,1,1,1,1,1,1,1,1,1,1,0,0,0,0,0,0,0,0,0,0,0,0,1]},"daily_units":{"time":"unixtime","weather_code":"wmo code","temperature_2m_max":"°C","temperature_2m_min":"°C","apparent_temperature_max":"°C","apparent_temperature_min":"°C","sunrise":"unixtime","sunset":"unixtime","sunshine_duration":"s","uv_index_max":"","precipitation_sum":"mm","snowfall_sum":"cm","precipitation_hours":"h","precipitation_probability_max":"%","wind_speed_10m_max":"km/h","wind_gusts_10m_max":"km/h","wind_direction_10m_dominant":"°"},"daily":{"time":[1793980800,1794067200,1794153600,1794240000,1794326400,1794412800,1794499200],"weather_code":[51,80,81,95,80,55,55],"temperature_2m_max":[30.3,29.8,29.8,30.3,30.1,28.8,29.5],"temperature_2m_min":[24.4,24.8,23.6,23.1,23.9,23.8,23.6],"apparent_temperature_max":[37.3,36.0,36.8,38.3,36.7,34.9,34.5],"apparent_temperature_min":[29.8,29.6,28.0,27.0,28.5,28.9,30.1],"sunrise":[1794005178,1794091583,1794177988,1794264395,1794350802,1794437210,1794523618],"sunset":[1794048613,1794135015,1794221419,1794307823,1794394227,1794480633,1794567039],"sunshine_duration":[39420.35,35191.87,36248.08,37515.28,33726.94,36169.26,42429.56],"uv_index_max":[8.75,8.60,8.50,6.15,8.60,8.75,8.75],"precipitation_sum":[1.00,7.40,7.10,10.80,8.70,5.70,15.30],"snowfall_sum":[0.00,0.00,0.00,0.00,0.00,0.00,0.00],"precipitation_hours":[7.0,16.0,13.0,11.0,9.0,18.0,21.0],"precipitation_probability_max":[90,100,100,98,96,87,92],"wind_speed_10m_max":[9.1,10.3,8.5,8.4,8.1,9.3,7.3],"wind_gusts_10m_max":[23.8,27.4,27.7,27.0,27.7,26.3,31.0],"wind_direction_10m_dominant":[3,35,356,342,338,244,242]}})OM"
