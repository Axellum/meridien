// FICHIER GÉNÉRÉ par test/host/controle_python_modeles.py : ne pas modifier à la main.
// Réponse réelle d'Open-Meteo (noaa, New York, requête complète du firmware + models=), voir donnees/LISEZMOI.md.
R"OM({"latitude":40.710335,"longitude":-73.99308,"generationtime_ms":1.7688274383544922,"utc_offset_seconds":-18000,"timezone":"America/New_York","timezone_abbreviation":"GMT-5","elevation":32.0,"current_units":{"time":"unixtime","interval":"seconds","temperature_2m":"°C","apparent_temperature":"°C","is_day":"","precipitation":"mm","weather_code":"wmo code","cloud_cover":"%","wind_speed_10m":"km/h","wind_direction_10m":"°","wind_gusts_10m":"km/h","pressure_msl":"hPa","relative_humidity_2m":"%"},"current":{"time":1794040200,"interval":900,"temperature_2m":14.3,"apparent_temperature":14.2,"is_day":0,"precipitation":0.00,"weather_code":2,"cloud_cover":50,"wind_speed_10m":5.7,"wind_direction_10m":266,"wind_gusts_10m":20.5,"pressure_msl":1009.3,"relative_humidity_2m":88},"minutely_15_units":{"time":"unixtime","precipitation":"mm"},"minutely_15":{"time":[1794040200,1794041100,1794042000,1794042900,1794043800,1794044700,1794045600,1794046500,1794047400],"precipitation":[0.00,0.00,0.00,0.00,0.00,0.00,0.00,0.00,0.00]},"hourly_units":{"time":"unixtime","temperature_2m":"°C","apparent_temperature":"°C","relative_humidity_2m":"%","precipitation_probability":"%","precipitation":"mm","weather_code":"wmo code","cloud_cover":"%","wind_speed_10m":"km/h","wind_direction_10m":"°","wind_gusts_10m":"km/h","uv_index":"","is_day":""},"hourly":{"time":[1794038400,1794042000,1794045600,1794049200,1794052800,1794056400,1794060000,1794063600,1794067200,1794070800,1794074400,1794078000,1794081600,1794085200,1794088800,1794092400,1794096000,1794099600,1794103200,1794106800,1794110400,1794114000,1794117600,1794121200,1794124800],"temperature_2m":[14.5,13.8,12.9,12.7,12.3,13.5,14.5,14.8,15.7,15.6,15.3,14.6,13.7,11.9,10.1,9.3,8.6,8.2,7.7,7.3,7.0,7.1,7.5,7.0,7.0],"apparent_temperature":[14.6,13.4,12.1,11.5,11.6,12.5,13.3,13.6,14.6,13.8,13.0,11.7,10.4,8.6,7.1,6.5,5.6,5.3,4.5,4.0,3.6,3.2,3.6,3.7,3.1],"relative_humidity_2m":[89,88,90,90,91,88,86,84,80,78,74,72,67,71,72,74,74,78,79,79,80,78,80,82,80],"precipitation_probability":[4,1,1,1,1,0,1,1,1,2,1,0,0,1,1,1,1,1,1,1,2,2,2,2,2],"precipitation":[0.00,0.00,0.00,0.00,0.00,0.00,0.00,0.00,0.00,0.00,0.00,0.00,0.00,0.00,0.00,0.00,0.00,0.00,0.00,0.00,0.00,0.00,0.00,0.00,0.00],"weather_code":[3,0,0,1,0,0,0,0,0,1,1,1,0,0,0,0,0,0,0,0,0,3,3,0,0],"cloud_cover":[100,0,1,27,8,5,7,9,18,26,21,21,0,0,0,0,0,5,5,0,0,100,100,0,8],"wind_speed_10m":[5.5,6.6,8.6,10.2,6.6,10.2,12.9,13.1,12.5,16.2,17.7,19.1,18.1,17.2,13.2,10.8,11.2,10.7,12.3,12.7,13.7,15.9,17.7,13.0,16.7],"wind_direction_10m":[253,275,307,327,334,343,315,301,296,283,290,289,290,294,296,283,286,271,281,278,285,279,280,278,277],"wind_gusts_10m":[21.2,15.1,22.7,25.9,22.3,25.9,23.8,19.1,17.6,23.0,25.2,28.1,30.6,36.0,35.3,32.0,26.6,24.1,27.4,27.7,29.5,38.2,45.0,28.4,41.0],"uv_index":[0.00,0.00,0.00,0.00,0.05,0.35,1.00,1.15,2.00,3.55,3.35,2.70,1.80,0.80,0.10,0.00,0.00,0.00,0.00,0.00,0.00,0.00,0.00,0.00,0.00],"is_day":[0,0,0,0,1,1,1,1,1,1,1,1,1,1,0,0,0,0,0,0,0,0,0,0,0]},"daily_units":{"time":"unixtime","weather_code":"wmo code","temperature_2m_max":"°C","temperature_2m_min":"°C","apparent_temperature_max":"°C","apparent_temperature_min":"°C","sunrise":"unixtime","sunset":"unixtime","sunshine_duration":"s","uv_index_max":"","precipitation_sum":"mm","snowfall_sum":"cm","precipitation_hours":"h","precipitation_probability_max":"%","wind_speed_10m_max":"km/h","wind_gusts_10m_max":"km/h","wind_direction_10m_dominant":"°"},"daily":{"time":[1794027600,1794114000,1794200400,1794286800,1794373200,1794459600,1794546000],"weather_code":[51,3,3,3,51,53,81],"temperature_2m_max":[15.7,14.3,13.9,17.3,15.4,14.3,14.9],"temperature_2m_min":[7.0,6.7,9.9,9.4,11.0,10.6,9.9],"apparent_temperature_max":[15.8,10.7,7.9,12.9,13.0,13.1,13.5],"apparent_temperature_min":[3.6,3.1,4.6,5.8,9.2,6.6,5.9],"sunrise":[1794051208,1794137680,1794224151,1794310623,1794397094,1794483565,1794570036],"sunset":[1794087928,1794174265,1794260603,1794346943,1794433285,1794519629,1794605975],"sunshine_duration":[34581.84,32400.00,34822.00,34735.90,33804.88,33003.62,22186.92],"uv_index_max":[3.55,3.40,3.10,3.40,3.10,2.90,1.55],"precipitation_sum":[0.40,0.00,0.00,0.00,0.10,0.70,60.30],"snowfall_sum":[0.00,0.00,0.00,0.00,0.00,0.00,0.00],"precipitation_hours":[2.0,0.0,0.0,0.0,1.0,3.0,24.0],"precipitation_probability_max":[18,3,4,0,0,25,35],"wind_speed_10m_max":[19.1,21.6,31.6,25.2,12.2,26.7,33.9],"wind_gusts_10m_max":[36.0,45.0,49.3,41.4,28.4,45.0,69.5],"wind_direction_10m_dominant":[288,266,286,259,227,32,79]}})OM"
