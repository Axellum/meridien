// FICHIER GÉNÉRÉ par test/host/controle_python_vigie.py (lecture indépendante de la réponse, langue de l'écran « fr ») : ne pas modifier.
{
    1794041561LL, // server_utc (-1 : inconnu)
    1, 1, 0, 0, 0, 0, // gardées, lues, doublons, omises, ignorées, couverture (1 périmée, 2 absente, 4 non rattachables, 8 pays sans source)
    R"VG(Source: EUMETNET – MeteoAlarm (https://meteoalarm.org/en/live/), warnings of the national meteorological and hydrological services. Terms equivalent to CC BY 4.0 with additional requirements for redistributors)VG",
    R"VG(Time delays between this website and the www.meteoalarm.org website are possible. For the most up-to-date awareness information as published by the participating National Meteorological and Hydrological Services, please refer to www.meteoalarm.org.)VG",
    {
        {2, 1, 2, 1793960808LL, -1LL, 1793959200LL, 1794045600LL, -1LL, 0, 0,
         R"VG(NO)VG", R"VG(Yellow)VG", R"VG(Wind)VG", R"VG(Gale)VG", R"VG(Meteorologisk Institutt)VG", R"VG(Stoett - Loedingen)VG",
         R"VG(Source: EUMETNET – MeteoAlarm (https://meteoalarm.org/en/live/), warnings of the national meteorological and hydrological services. Terms equivalent to CC BY 4.0 with additional requirements for redistributors | Issued by Meteorologisk Institutt)VG", 1,
         {
             {R"VG(en-GB)VG", R"VG(Gale, yellow level, Stoett - Loedingen, 2026-11-06T10:00:00+00:00, 2026-11-07T10:00:00+00:00)VG", R"VG(From Friday late morning south west occasional near gale force 7. Occasional weakening Friday afternoon.)VG", R"VG(Consider not taking the boat out: Risk of dangerous situations when in a small boat at sea. If the engine stops you can float towards land.)VG", 0},
         }},
    },
    { // instants de contrôle : maintenant, réponse reçue 60 s avant, niveau minimal, indices des alertes montrées (plus grave d'abord)
        {1793959199LL, 0, 0, {}},
        {1793959199LL, 1, 0, {}},
        {1793959199LL, 2, 0, {}},
        {1793959200LL, 0, 1, {0}},
        {1793959200LL, 1, 0, {}},
        {1793959200LL, 2, 0, {}},
        {1793959201LL, 0, 1, {0}},
        {1793959201LL, 1, 0, {}},
        {1793959201LL, 2, 0, {}},
        {1794041561LL, 0, 1, {0}},
        {1794041561LL, 1, 0, {}},
        {1794041561LL, 2, 0, {}},
        {1794045599LL, 0, 1, {0}},
        {1794045599LL, 1, 0, {}},
        {1794045599LL, 2, 0, {}},
        {1794045600LL, 0, 0, {}},
        {1794045600LL, 1, 0, {}},
        {1794045600LL, 2, 0, {}},
        {1794045601LL, 0, 0, {}},
        {1794045601LL, 1, 0, {}},
        {1794045601LL, 2, 0, {}},
    },
}
